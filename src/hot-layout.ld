/* Generated by bench/layout/regen.sh: code and constants a serving worker uses,
 * placed side by side so they share pages. Do not edit by hand. */
SECTIONS {
  .text.hot : {
    *(.text.server.h3.service)
    *(.text.endpoint.Endpoint.flush)
    *(.text.server.conn.Conn.init)
    *(.text.server.net.localAddr)
    *(.text.server.conn.Conn.drive)
    *(.text.server.conn.Conn.recv)
    *(.text.mem.eqlBytes)
    *(.text.mem.findScalar__func_64)
    *(.text.http.request.normalizePath)
    *(.text.http.request.anyByte__func_1458)
    *(.text.server.router.selectServer)
    *(.text.server.router.normalizeHost)
    *(.text.http.config.Listen.defaultFor)
    *(.text.server.conn.Conn.beginRequest)
    *(.text.server.handler.runStmts)
    *(.text.server.handler.findAndRun)
    *(.text.server.router.find)
    *(.text.server.policy.check)
    *(.text.server.handler.content)
    *(.text.server.handler.accessAllowed)
    *(.text.server.vars.eval)
    *(.text.server.vars.appendVar)
    *(.text.heap.FixedBufferAllocator.alloc)
    *(.text.compiler_rt.memcpy.memcpyFast)
    *(.text.server.vars.mapUri)
    *(.text.server.vars.evalDepth)
    *(.text.server.filecache.Cache.stat)
    *(.text.hash.wyhash.Wyhash.hash)
    *(.text.server.handler.contentHandler)
    *(.text.server.filecache.Cache.open)
    *(.text.server.handler.serveOpenFile)
    *(.text.server.handler.contentType)
    *(.text.server.handler.compressible)
    *(.text.server.handler.writeHead)
    *(.text.server.handler.writeHeadTo)
    *(.text.http.response.reason)
    *(.text.http.response.httpDate)
    *(.text.Io.Writer.alignBufferOptions)
    *(.text.Io.Writer.splatByteAll)
    *(.text.compiler_rt.fastMemset)
    *(.text.Io.Writer.writeAll)
    *(.text.Io.Writer.print__func_1094)
    *(.text.Io.Writer.print__func_1096)
    *(.text.Io.Writer.print__func_1098)
    *(.text.server.filecache.bus.copy)
    *(.text.server.conn.Conn.bodyDone)
    *(.text.server.conn.Conn.flush)
    *(.text.server.conn.Conn.sendRaw)
    *(.text.server.conn.Conn.finishRequest)
    *(.text.server.worker.Worker.accessLog)
    *(.text.server.conn.Conn.releaseData)
    *(.text.heap.c_allocator_impl.alloc)
    *(.text.server.conn.Conn.close)
    *(.text.SSL_new)
    *(.text.ossl_ssl_connection_new)
    *(.text.ossl_ssl_connection_new_int)
    *(.text.CRYPTO_zalloc)
    *(.text.CRYPTO_malloc)
    *(.text.server.tls.buffer_pool.alloc)
    *(.text.ossl_ssl_init)
    *(.text.SSL_CTX_up_ref)
    *(.text.__aarch64_ldadd4_relax)
    *(.text.CRYPTO_THREAD_lock_new)
    *(.text.CRYPTO_new_ex_data)
    *(.text.ossl_crypto_new_ex_data_ex)
    *(.text.ossl_lib_ctx_get_ex_data_global)
    *(.text.ossl_lib_ctx_get_concrete)
    *(.text.CRYPTO_THREAD_run_once)
    *(.text.CRYPTO_THREAD_get_local)
    *(.text.CRYPTO_THREAD_read_lock)
    *(.text.OPENSSL_sk_num)
    *(.text.CRYPTO_THREAD_unlock)
    *(.text.CRYPTO_free)
    *(.text.server.tls.buffer_pool.free)
    *(.text.RECORD_LAYER_init)
    *(.text.OPENSSL_sk_dup)
    *(.text.ssl_cert_dup)
    *(.text.X509_up_ref)
    *(.text.EVP_PKEY_up_ref)
    *(.text.custom_exts_copy)
    *(.text.X509_VERIFY_PARAM_new)
    *(.text.X509_VERIFY_PARAM_inherit)
    *(.text.OSSL_QUIC_client_method)
    *(.text.OSSL_QUIC_client_thread_method)
    *(.text.OSSL_QUIC_server_method)
    *(.text.CRYPTO_memdup)
    *(.text.tls1_new)
    *(.text.ssl3_new)
    *(.text.ssl_srp_ctx_init_intern)
    *(.text.tls1_clear)
    *(.text.ssl3_clear)
    *(.text.ssl3_cleanup_key_block)
    *(.text.CRYPTO_clear_free)
    *(.text.OPENSSL_sk_pop_free)
    *(.text.EVP_PKEY_free)
    *(.text.ssl3_free_digest_list)
    *(.text.BIO_free)
    *(.text.EVP_MD_CTX_free)
    *(.text.ssl_free_wbio_buffer)
    *(.text.ossl_ssl_connection_reset)
    *(.text.ssl_clear_bad_session)
    *(.text.SSL_SESSION_free)
    *(.text.ossl_statem_clear)
    *(.text.ossl_statem_set_in_init)
    *(.text.BUF_MEM_free)
    *(.text.X509_free)
    *(.text.X509_it)
    *(.text.ASN1_item_free)
    *(.text.ossl_asn1_item_embed_free)
    *(.text.X509_VERIFY_PARAM_move_peername)
    *(.text.ossl_quic_tls_clear)
    *(.text.RECORD_LAYER_reset)
    *(.text.RECORD_LAYER_clear)
    *(.text.ssl_set_new_record_layer)
    *(.text.OSSL_PARAM_construct_uint64)
    *(.text.OSSL_PARAM_construct_uint32)
    *(.text.OSSL_PARAM_construct_size_t)
    *(.text.OSSL_PARAM_construct_int)
    *(.text.OSSL_PARAM_construct_end)
    *(.text.BIO_s_mem)
    *(.text.BIO_new)
    *(.text.BIO_new_ex)
    *(.text.mem_new)
    *(.text.BUF_MEM_new_ex)
    *(.text.BUF_MEM_new)
    *(.text.tls_new_record_layer)
    *(.text.tls_int_new_record_layer)
    *(.text.tls_set1_bio)
    *(.text.BIO_free_all)
    *(.text.BIO_up_ref)
    *(.text.tls_set_options)
    *(.text.OSSL_PARAM_locate)
    *(.text.OSSL_PARAM_get_uint64)
    *(.text.OSSL_PARAM_get_uint32)
    *(.text.tls_any_set_crypto_state)
    *(.text.tls_set_first_handshake)
    *(.text.ssl_get_max_send_fragment)
    *(.text.SSL_set_ct_validation_callback)
    *(.text.SSL_set_fd)
    *(.text.BIO_s_socket)
    *(.text.sock_new)
    *(.text.BIO_int_ctrl)
    *(.text.BIO_ctrl)
    *(.text.sock_ctrl)
    *(.text.SSL_set_bio)
    *(.text.SSL_get_rbio)
    *(.text.SSL_get_wbio)
    *(.text.SSL_set0_rbio)
    *(.text.SSL_set0_wbio)
    *(.text.ERR_clear_error)
    *(.text.ossl_err_get_state_int)
    *(.text.OPENSSL_init_crypto)
    *(.text.CRYPTO_atomic_load)
    *(.text.SSL_accept)
    *(.text.SSL_set_accept_state)
    *(.text.__aarch64_ldadd4_rel)
    *(.text.tls_free)
    *(.text.tls_int_free)
    *(.text.mem_free)
    *(.text.CRYPTO_free_ex_data)
    *(.text.OPENSSL_sk_free)
    *(.text.ossl_tls_buffer_release)
    *(.text.EVP_CIPHER_CTX_free)
    *(.text.EVP_MAC_CTX_free)
    *(.text.COMP_CTX_free)
    *(.text.SSL_do_handshake)
    *(.text.ossl_statem_check_finish_init)
    *(.text.ssl3_renegotiate_check)
    *(.text.SSL_in_init)
    *(.text.ossl_statem_accept)
    *(.text.state_machine)
    *(.text.SSL_in_before)
    *(.text.SSL_clear)
    *(.text.ssl_security)
    *(.text.ssl_security_default_callback)
    *(.text.ssl_get_security_level_bits)
    *(.text.SSL_get_security_level)
    *(.text.BUF_MEM_grow)
    *(.text.CRYPTO_realloc)
    *(.text.server.tls.buffer_pool.realloc)
    *(.text.ssl_init_wbio_buffer)
    *(.text.BIO_f_buffer)
    *(.text.buffer_new)
    *(.text.buffer_ctrl)
    *(.text.BIO_push)
    *(.text.tls_setup_handshake)
    *(.text.ssl3_init_finished_mac)
    *(.text.mem_ctrl)
    *(.text.ssl_get_min_max_version)
    *(.text.tlsv1_3_client_method)
    *(.text.ssl_version_cmp)
    *(.text.tlsv1_2_client_method)
    *(.text.tlsv1_1_client_method)
    *(.text.tlsv1_client_method)
    *(.text.SSL_get_ciphers)
    *(.text.OPENSSL_sk_value)
    *(.text.ossl_statem_server_write_transition)
    *(.text.tls_get_message_header)
    *(.text.ssl3_read_bytes)
    *(.text.ossl_statem_get_in_handshake)
    *(.text.tls_read_record)
    *(.text.tls_get_more_records)
    *(.text.tls_setup_read_buffer)
    *(.text.tls_default_read_n)
    *(.text.BIO_read)
    *(.text.bread_conv)
    *(.text.sock_read)
    *(.text.BIO_clear_flags)
    *(.text.tls_validate_record_header)
    *(.text.ERR_set_mark)
    *(.text.tls_any_cipher)
    *(.text.ERR_clear_last_mark)
    *(.text.tls_default_post_process_record)
    *(.text.ossl_tls_handle_rlayer_return)
    *(.text.tls_processed_read_pending)
    *(.text.ssl_release_record)
    *(.text.tls_release_record)
    *(.text.RECORD_LAYER_is_sslv2_record)
    *(.text.ossl_statem_server_read_transition)
    *(.text.ossl_statem_server_max_message_size)
    *(.text.tls_get_message_body)
    *(.text.BUF_MEM_grow_clean)
    *(.text.ssl3_finish_mac)
    *(.text.BIO_write)
    *(.text.bwrite_conv)
    *(.text.mem_write)
    *(.text.CRYPTO_clear_realloc)
    *(.text.ossl_statem_server_process_message)
    *(.text.tls_process_client_hello)
    *(.text.tls_collect_extensions)
    *(.text.custom_ext_init)
    *(.text.extension_is_relevant)
    *(.text.init_server_name)
    *(.text.init_srp)
    *(.text.init_ec_point_formats)
    *(.text.init_session_ticket)
    *(.text.init_status_request)
    *(.text.init_npn)
    *(.text.init_alpn)
    *(.text.init_srtp)
    *(.text.init_etm)
    *(.text.init_ems)
    *(.text.init_sig_algs_cert)
    *(.text.init_client_cert_type)
    *(.text.init_server_cert_type)
    *(.text.init_sig_algs)
    *(.text.ossl_statem_server_post_process_message)
    *(.text.tls_post_process_client_hello)
    *(.text.ssl_choose_server_version)
    *(.text.ssl_version_supported)
    *(.text.tlsv1_3_server_method)
    *(.text.ssl_method_error)
    *(.text.ssl_set_record_protocol_version)
    *(.text.tls_set_protocol_version)
    *(.text.tls_any_set_protocol_version)
    *(.text.RECORD_LAYER_processed_read_pending)
    *(.text.ssl_cache_cipherlist)
    *(.text.ossl_bytes_to_cipher_list)
    *(.text.OPENSSL_sk_new_null)
    *(.text.OPENSSL_sk_new_reserve)
    *(.text.ssl_get_cipher_by_char)
    *(.text.ssl3_get_cipher_by_char)
    *(.text.ssl3_get_cipher_by_id)
    *(.text.OBJ_bsearch_ssl_cipher_id)
    *(.text.OBJ_bsearch_)
    *(.text.ossl_bsearch)
    *(.text.ssl_cipher_id_cmp_BSEARCH_CMP_FN)
    *(.text.ssl_cipher_id_cmp)
    *(.text.OPENSSL_sk_push)
    *(.text.OPENSSL_sk_insert)
    *(.text.SSL_CIPHER_get_id)
    *(.text.ssl3_choose_cipher)
    *(.text.OPENSSL_sk_find)
    *(.text.tls_parse_extension)
    *(.text.ssl_get_prev_session)
    *(.text.tls_parse_ctos_psk_kex_modes)
    *(.text.ssl_get_new_session)
    *(.text.SSL_SESSION_new)
    *(.text.OPENSSL_init_ssl)
    *(.text.ossl_time_now)
    *(.text.ssl_session_calculate_timeout)
    *(.text.tls_parse_all_extensions)
    *(.text.tls_parse_ctos_supported_groups)
    *(.text.tls1_save_u16)
    *(.text.tls_parse_ctos_status_request)
    *(.text.tls_parse_ctos_sig_algs)
    *(.text.tls1_save_sigalgs)
    *(.text.tls_parse_ctos_key_share)
    *(.text.tls1_get_supported_groups)
    *(.text.tls1_get_group_tuples)
    *(.text.check_in_list)
    *(.text.tls_group_allowed)
    *(.text.tls1_group_id_lookup)
    *(.text.tls1_group_id2nid)
    *(.text.tls_valid_group)
    *(.text.check_overlap)
    *(.text.tls_accept_ksgroup)
    *(.text.ssl_generate_param_group)
    *(.text.EVP_PKEY_CTX_new_from_name)
    *(.text.evp_pkey_name2type)
    *(.text.OPENSSL_strcasecmp)
    *(.text.ossl_tolower)
    *(.text.OBJ_sn2nid)
    *(.text.sn_cmp_BSEARCH_CMP_FN)
    *(.text.EVP_PKEY_type)
    *(.text.EVP_PKEY_asn1_find)
    *(.text.pkey_asn1_find)
    *(.text.ameth_cmp_BSEARCH_CMP_FN)
    *(.text.ENGINE_get_pkey_asn1_meth_engine)
    *(.text.ossl_engine_table_select)
    *(.text.ENGINE_finish)
    *(.text.OBJ_ln2nid)
    *(.text.ln_cmp_BSEARCH_CMP_FN)
    *(.text.EVP_KEYMGMT_fetch)
    *(.text.evp_generic_fetch)
    *(.text.ossl_lib_ctx_get_data)
    *(.text.ossl_namemap_stored)
    *(.text.ossl_namemap_empty)
    *(.text.ossl_namemap_name2num)
    *(.text.ossl_ht_get)
    *(.text.ossl_fnv1a_hash)
    *(.text.ossl_rcu_uptr_deref)
    *(.text.compiler_rt.memcmp)
    *(.text.ossl_method_store_cache_get)
    *(.text.ossl_sa_get)
    *(.text.OPENSSL_LH_retrieve)
    *(.text.getrn)
    *(.text.lh_QUERY_hfn_thunk)
    *(.text.query_hash)
    *(.text.OPENSSL_LH_strhash)
    *(.text.lh_QUERY_cfn_thunk)
    *(.text.query_cmp)
    *(.text.evp_keymgmt_up_ref)
    *(.text.EVP_KEYMGMT_up_ref)
    *(.text.evp_keymgmt_get_legacy_alg)
    *(.text.EVP_PKEY_paramgen_init)
    *(.text.evp_pkey_ctx_free_old_ops)
    *(.text.evp_keymgmt_gen_init)
    *(.text.EVP_KEYMGMT_get0_provider)
    *(.text.ossl_provider_ctx)
    *(.text.mlx_x25519_kem_gen_init)
    *(.text.ossl_prov_ctx_get0_libctx)
    *(.text.ossl_prov_is_running)
    *(.text.EVP_PKEY_CTX_set_group_name)
    *(.text.OSSL_PARAM_construct_utf8_string)
    *(.text.compiler_rt.strlen)
    *(.text.EVP_PKEY_CTX_set_params)
    *(.text.evp_pkey_ctx_state)
    *(.text.evp_keymgmt_gen_set_params)
    *(.text.mlx_kem_gen_set_params)
    *(.text.EVP_PKEY_paramgen)
    *(.text.EVP_PKEY_generate)
    *(.text.EVP_PKEY_new)
    *(.text.evp_keymgmt_util_gen)
    *(.text.evp_keymgmt_gen)
    *(.text.mlx_kem_gen)
    *(.text.ossl_ml_kem_get_vinfo)
    *(.text.evp_keymgmt_util_assign_pkey)
    *(.text.EVP_PKEY_set_type_by_keymgmt)
    *(.text.EVP_KEYMGMT_names_do_all)
    *(.text.evp_names_do_all)
    *(.text.ossl_provider_libctx)
    *(.text.ossl_namemap_doall_names)
    *(.text.find_ameth)
    *(.text.EVP_PKEY_asn1_find_str)
    *(.text.ENGINE_pkey_asn1_find_str)
    *(.text.engine_table_doall)
    *(.text.EVP_PKEY_asn1_get_count)
    *(.text.EVP_PKEY_asn1_get0)
    *(.text.ERR_new)
    *(.text.ERR_set_debug)
    *(.text.ERR_set_error)
    *(.text.ERR_vset_error)
    *(.text.ERR_pop_to_mark)
    *(.text.pkey_set_type)
    *(.text.evp_keymgmt_util_cache_keyinfo)
    *(.text.evp_keymgmt_get_params)
    *(.text.mlx_kem_get_params)
    *(.text.OSSL_PARAM_set_int32)
    *(.text.evp_pkey_free_legacy)
    *(.text.EVP_PKEY_CTX_free)
    *(.text.evp_keymgmt_gen_cleanup)
    *(.text.mlx_kem_gen_cleanup)
    *(.text.EVP_KEYMGMT_free)
    *(.text.BN_free)
    *(.text.tls13_set_encoded_pub_key)
    *(.text.EVP_PKEY_is_a)
    *(.text.EVP_KEYMGMT_is_a)
    *(.text.evp_is_a)
    *(.text.EVP_PKEY_set1_encoded_public_key)
    *(.text.EVP_PKEY_set_octet_string_param)
    *(.text.OSSL_PARAM_construct_octet_string)
    *(.text.EVP_PKEY_set_params)
    *(.text.evp_keymgmt_set_params)
    *(.text.mlx_kem_set_params)
    *(.text.OSSL_PARAM_get_octet_string_ptr)
    *(.text.OSSL_PARAM_get_octet_ptr)
    *(.text.load_slot.constprop.0)
    *(.text.EVP_PKEY_fromdata_init)
    *(.text.EVP_PKEY_fromdata)
    *(.text.evp_keymgmt_util_fromdata)
    *(.text.evp_keymgmt_newdata)
    *(.text.ml_kem_768_new)
    *(.text.ossl_prov_ml_kem_new)
    *(.text.ossl_ml_kem_key_new)
    *(.text.EVP_MD_fetch)
    *(.text.ossl_method_construct)
    *(.text.ossl_algorithm_do_all)
    *(.text.ossl_provider_doall_activated)
    *(.text.ossl_lib_ctx_is_default)
    *(.text.provider_activate_fallbacks)
    *(.text.CRYPTO_atomic_add)
    *(.text.__aarch64_ldadd4_acq_rel)
    *(.text.algorithm_do_this)
    *(.text.ossl_provider_query_operation)
    *(.text.deflt_query)
    *(.text.ossl_method_construct_reserve_store)
    *(.text.reserve_evp_method_store)
    *(.text.ossl_method_lock_store)
    *(.text.CRYPTO_THREAD_write_lock)
    *(.text.ossl_method_construct_precondition)
    *(.text.ossl_provider_test_operation_bit)
    *(.text.ossl_method_construct_unreserve_store)
    *(.text.unreserve_evp_method_store)
    *(.text.ossl_method_unlock_store)
    *(.text.ossl_provider_unquery_operation)
    *(.text.get_evp_method_from_store)
    *(.text.ossl_method_store_fetch)
    *(.text.ossl_parse_query)
    *(.text.OPENSSL_sk_new)
    *(.text.ossl_ctype_check)
    *(.text.stack_to_property_list)
    *(.text.OPENSSL_sk_sort)
    *(.text.ossl_ctx_global_properties)
    *(.text.ossl_property_has_optional)
    *(.text.ossl_property_match_count)
    *(.text.evp_md_up_ref)
    *(.text.EVP_MD_up_ref)
    *(.text.ossl_property_free)
    *(.text.ossl_method_store_cache_set)
    *(.text.OPENSSL_LH_insert)
    *(.text.OPENSSL_LH_error)
    *(.text.ossl_prov_ctx_get_param)
    *(.text.core_get_params)
    *(.text.OSSL_PROVIDER_get_conf_parameters)
    *(.text.OSSL_PARAM_modified)
    *(.text.ossl_prov_ctx_get_bool_param)
    *(.text.evp_keymgmt_import)
    *(.text.ml_kem_import)
    *(.text.ossl_ml_kem_parse_public_key)
    *(.text.EVP_MD_CTX_new)
    *(.text.parse_pubkey)
    *(.text.EVP_DigestInit_ex)
    *(.text.evp_md_init_internal)
    *(.text.EVP_MD_CTX_clear_flags)
    *(.text.ENGINE_get_digest_engine)
    *(.text.cleanup_old_md_data)
    *(.text.evp_md_ctx_free_algctx)
    *(.text.EVP_MD_free)
    *(.text.sha3_256_newctx)
    *(.text.ossl_sha3_init)
    *(.text.ossl_sha3_reset)
    *(.text.keccak_init)
    *(.text.EVP_DigestUpdate)
    *(.text.keccak_update)
    *(.text.generic_sha3_absorb)
    *libcrypto-lib-keccak1600-armv8.o(.text)
    *(.text.EVP_MD_CTX_get0_md)
    *(.text.EVP_MD_xof)
    *(.text.EVP_MD_get_flags)
    *(.text.EVP_DigestFinal_ex)
    *(.text.EVP_MD_CTX_get_size_ex)
    *(.text.EVP_MD_CTX_gettable_params)
    *(.text.EVP_MD_get_size)
    *(.text.keccak_final)
    *(.text.generic_sha3_final)
    *(.text.ossl_sha3_final)
    *(.text.matrix_expand)
    *(.text.keccak_freectx)
    *libcrypto-lib-arm64cpuid.o(.text)
    *(.text.shake_128_newctx)
    *(.text.ossl_keccak_init)
    *(.text.keccak_init_params)
    *(.text.EVP_DigestSqueeze)
    *(.text.shake_squeeze)
    *(.text.generic_sha3_squeeze)
    *(.text.ossl_sha3_squeeze)
    *(.text.EVP_MD_CTX_reset)
    *(.text.EVP_MD_CTX_test_flags)
    *(.text.evp_md_ctx_clear_digest)
    *(.text.EVP_MD_CTX_set_flags)
    *(.text.ml_kem_pairwise_test)
    *(.text.OPENSSL_strncasecmp)
    *(.text.ml_kem_get_params)
    *(.text.OBJ_nid2sn)
    *(.text.OBJ_nid2obj)
    *(.text.ENGINE_get_pkey_meth_engine)
    *(.text.x25519_new_key)
    *(.text.ossl_ecx_key_new)
    *(.text.ecx_import)
    *(.text.ossl_ecx_key_fromdata)
    *(.text.OSSL_PARAM_get_octet_string)
    *(.text.x25519_get_params)
    *(.text.ossl_param_build_set_octet_string)
    *(.text.final_renegotiate)
    *(.text.final_server_name)
    *(.text.SSL_get_options)
    *(.text.server.tls.sniCallback)
    *(.text.SSL_get_servername)
    *(.text.SSL_get_rfd)
    *(.text.BIO_find_type)
    *(.text.SSL_set_SSL_CTX)
    *(.text.final_maxfragmentlen)
    *(.text.final_ec_pt_formats)
    *(.text.final_alpn)
    *(.text.tls_handle_alpn)
    *(.text.final_ems)
    *(.text.final_sig_algs)
    *(.text.final_supported_versions)
    *(.text.final_key_share)
    *(.text.final_early_data)
    *(.text.final_psk)
    *(.text.ssl_fill_hello_random)
    *(.text.RAND_bytes_ex)
    *(.text.RAND_get_rand_method)
    *(.text.RAND_OpenSSL)
    *(.text.EVP_RAND_generate)
    *(.text.ossl_drbg_lock)
    *(.text.evp_rand_generate_locked)
    *(.text.drbg_ctr_get_ctx_params)
    *(.text.ossl_drbg_get_ctx_params_no_lock)
    *(.text.OSSL_PARAM_set_uint64)
    *(.text.drbg_ctr_generate_wrapper)
    *(.text.ossl_prov_drbg_generate)
    *(.text.get_parent_reseed_count)
    *(.text.OSSL_PARAM_construct_uint)
    *(.text.OSSL_PARAM_set_uint32)
    *(.text.ossl_drbg_unlock)
    *(.text.drbg_ctr_generate)
    *(.text.EVP_CipherInit_ex)
    *(.text.evp_cipher_init_internal)
    *(.text.EVP_CIPHER_CTX_get_iv_length)
    *(.text.ossl_cipher_generic_einit)
    *(.text.ossl_cipher_generic_initiv)
    *(.text.ossl_cipher_generic_set_ctx_params)
    *(.text.EVP_CipherUpdate)
    *(.text.EVP_EncryptUpdate)
    *(.text.ossl_cipher_generic_stream_update)
    *(.text.ossl_cipher_hw_generic_ctr)
    *(.text.CRYPTO_ctr128_encrypt_ctr32)
    *libcrypto-lib-aesv8-armx.o(.text)
    *(.text.ctr_update)
    *(.text.ossl_cipher_generic_block_update)
    *(.text.ossl_cipher_hw_generic_ecb)
    *(.text.EVP_CIPHER_CTX_get_key_length)
    *(.text.cipher_hw_aes_arm_initkey)
    *(.text.tls1_set_server_sigalgs)
    *(.text.tls1_process_sigalgs)
    *(.text.tls12_get_psigalgs)
    *(.text.tls12_shared_sigalgs)
    *(.text.tls12_sigalg_allowed)
    *(.text.ssl_cert_is_disabled)
    *(.text.ssl_cert_lookup_by_idx)
    *(.text.sigalg_security_bits)
    *(.text.tls1_lookup_md)
    *(.text.ssl_md)
    *(.text.EVP_MD_get_type)
    *(.text.tls_choose_sigalg)
    *(.text.find_sig_alg)
    *(.text.tls_sigalg_compat)
    *(.text.has_usable_cert)
    *(.text.check_cert_usable.isra.0)
    *(.text.EVP_PKEY_digestsign_supports_digest)
    *(.text.EVP_DigestSignInit_ex)
    *(.text.do_sigver_init)
    *(.text.EVP_PKEY_CTX_new_from_pkey)
    *(.text.int_ctx_new)
    *(.text.EVP_KEYMGMT_get0_name)
    *(.text.evp_keymgmt_util_query_operation_name)
    *(.text.ec_query_operation_name)
    *(.text.EVP_SIGNATURE_free)
    *(.text.EVP_SIGNATURE_fetch)
    *(.text.evp_signature_up_ref)
    *(.text.EVP_SIGNATURE_up_ref)
    *(.text.EVP_SIGNATURE_get0_provider)
    *(.text.evp_keymgmt_fetch_from_prov)
    *(.text.evp_generic_fetch_from_prov)
    *(.text.evp_pkey_export_to_provider)
    *(.text.evp_keymgmt_util_export_to_provider)
    *(.text.ecdsa_newctx)
    *(.text.ecdsa_digest_sign_init)
    *(.text.EC_KEY_up_ref)
    *(.text.EC_KEY_free)
    *(.text.ecdsa_set_ctx_params)
    *(.text.ecdsa_setup_md.isra.0)
    *(.text.ossl_digest_get_approved_nid)
    *(.text.ossl_digest_md_to_nid)
    *(.text.EVP_MD_is_a)
    *(.text.WPACKET_init_der)
    *(.text.ossl_DER_w_algorithmIdentifier_ECDSA_with_MD)
    *(.text.ossl_DER_w_begin_sequence)
    *(.text.WPACKET_start_sub_packet)
    *(.text.WPACKET_start_sub_packet_len__)
    *(.text.ossl_DER_w_precompiled)
    *(.text.WPACKET_memcpy)
    *(.text.WPACKET_allocate_bytes)
    *(.text.WPACKET_reserve_bytes)
    *(.text.WPACKET_get_curr)
    *(.text.ossl_DER_w_end_sequence)
    *(.text.WPACKET_get_total_written)
    *(.text.WPACKET_close)
    *(.text.WPACKET_put_bytes__)
    *(.text.WPACKET_finish)
    *(.text.WPACKET_cleanup)
    *(.text.compiler_rt.memmove.memmoveFast)
    *(.text.OPENSSL_strlcpy)
    *(.text.EVP_DigestInit_ex2)
    *(.text.sha384_newctx)
    *(.text.sha384_internal_init)
    *(.text.SHA384_Init)
    *(.text.evp_pkey_ctx_use_cached_data)
    *(.text.ecdsa_freectx)
    *(.text.sha384_freectx)
    *(.text.BN_clear_free)
    *(.text.ssl_get_EC_curve_nid)
    *(.text.EVP_PKEY_get_group_name)
    *(.text.EVP_PKEY_get_utf8_string_param)
    *(.text.EVP_PKEY_get_params)
    *(.text.ec_get_params)
    *(.text.common_get_params)
    *(.text.EC_KEY_get0_group)
    *(.text.ossl_ec_key_get_libctx)
    *(.text.ossl_ec_key_get0_propq)
    *(.text.BN_CTX_new_ex)
    *(.text.BN_CTX_start)
    *(.text.EC_GROUP_get_field_type)
    *(.text.ossl_ec_group_todata)
    *(.text.EC_GROUP_get_point_conversion_form)
    *(.text.ossl_ec_pt_format_id2name)
    *(.text.ossl_param_build_set_utf8_string)
    *(.text.EC_GROUP_get_asn1_flag)
    *(.text.ossl_param_build_set_int)
    *(.text.EC_GROUP_get_curve_name)
    *(.text.OSSL_EC_curve_nid2name)
    *(.text.OSSL_PARAM_set_utf8_string)
    *(.text.EC_KEY_get0_private_key)
    *(.text.EC_KEY_get0_public_key)
    *(.text.EC_GROUP_order_bits)
    *(.text.ossl_ec_group_simple_order_bits)
    *(.text.BN_num_bits)
    *(.text.BN_is_zero)
    *(.text.BN_num_bits_word)
    *(.text.ossl_param_build_set_bn_pad)
    *(.text.BN_CTX_free)
    *(.text.EC_KEY_get_conv_form)
    *(.text.EC_KEY_get_flags)
    *(.text.ossl_ec_check_group_type_id2name)
    *(.text.EC_KEY_get_enc_flags)
    *(.text.BN_CTX_end)
    *(.text.OBJ_txt2nid)
    *(.text.OBJ_txt2obj)
    *(.text.OBJ_obj2nid)
    *(.text.ASN1_OBJECT_free)
    *(.text.sha256_newctx)
    *(.text.sha256_internal_init)
    *(.text.SHA256_Init)
    *(.text.sha256_freectx)
    *(.text.ossl_statem_server_pre_work)
    *(.text.ossl_statem_server_construct_message)
    *(.text.WPACKET_init)
    *(.text.WPACKET_init_len)
    *(.text.ssl3_set_handshake_header)
    *(.text.tls_construct_server_hello)
    *(.text.WPACKET_sub_memcpy__)
    *(.text.ssl3_put_cipher_by_char)
    *(.text.tls_construct_extensions)
    *(.text.custom_ext_add)
    *(.text.should_add_extension)
    *(.text.tls_construct_stoc_supported_versions)
    *(.text.tls_construct_stoc_key_share)
    *(.text.ssl_encapsulate)
    *(.text.EVP_PKEY_encapsulate_init)
    *(.text.evp_kem_init)
    *(.text.EVP_KEM_free)
    *(.text.EVP_KEM_fetch)
    *(.text.ossl_method_construct_this)
    *(.text.construct_evp_method)
    *(.text.ossl_namemap_add_names)
    *(.text.CRYPTO_strdup)
    *(.text.namemap_add_name)
    *(.text.evp_kem_from_algorithm)
    *(.text.ossl_provider_up_ref)
    *(.text.ossl_algorithm_get1_first_name)
    *(.text.CRYPTO_strndup)
    *(.text.OPENSSL_strnlen)
    *(.text.put_evp_method_in_store)
    *(.text.ossl_namemap_name2num_n)
    *(.text.ossl_method_store_add)
    *(.text.evp_kem_up_ref)
    *(.text.EVP_KEM_up_ref)
    *(.text.ossl_prop_defn_get)
    *(.text.ossl_lib_ctx_read_lock)
    *(.text.lh_PROPERTY_DEFN_ELEM_hfn_thunk)
    *(.text.property_defn_hash)
    *(.text.lh_PROPERTY_DEFN_ELEM_cfn_thunk)
    *(.text.property_defn_cmp)
    *(.text.ossl_lib_ctx_unlock)
    *(.text.OPENSSL_LH_new)
    *(.text.OPENSSL_LH_set_thunks)
    *(.text.ossl_sa_set)
    *(.text.destruct_evp_method)
    *(.text.evp_kem_free)
    *(.text.ossl_method_construct_postcondition)
    *(.text.ossl_provider_set_operation_bit)
    *(.text.EVP_KEM_get0_provider)
    *(.text.mlx_kem_newctx)
    *(.text.mlx_kem_encapsulate_init)
    *(.text.EVP_PKEY_encapsulate)
    *(.text.mlx_kem_encapsulate)
    *(.text.ml_kem_newctx)
    *(.text.ml_kem_encapsulate_init)
    *(.text.ml_kem_encapsulate)
    *(.text.ossl_ml_kem_encap_rand)
    *(.text.ossl_ml_kem_encap_seed)
    *(.text.encap)
    *(.text.sha3_512_newctx)
    *(.text.encrypt_cpa)
    *(.text.cbd_2)
    *(.text.shake_256_newctx)
    *(.text.EVP_DigestFinalXOF)
    *(.text.EVP_MD_CTX_set_params)
    *(.text.shake_set_ctx_params)
    *(.text.scalar_ntt)
    *(.text.scalar_mult)
    *(.text.scalar_inverse_ntt)
    *(.text.scalar_encode)
    *(.text.ml_kem_freectx)
    *(.text.EVP_PKEY_keygen_init)
    *(.text.x25519_gen_init)
    *(.text.ecx_gen_set_params)
    *(.text.EVP_PKEY_keygen)
    *(.text.evp_keymgmt_gen_set_template)
    *(.text.x25519_gen)
    *(.text.ossl_ecx_key_allocate_privkey)
    *(.text.CRYPTO_secure_zalloc)
    *(.text.RAND_priv_bytes_ex)
    *(.text.get_entropy)
    *(.text.get_parent_strength)
    *(.text.ossl_drbg_get_ctx_params)
    *(.text.ossl_drbg_get_seed)
    *(.text.CRYPTO_secure_malloc)
    *(.text.seed_src_lock)
    *(.text.seed_src_get_ctx_params)
    *(.text.seed_src_unlock)
    *(.text.ctr_BCC_update)
    *(.text.drbg_ctr_reseed)
    *(.text.cleanup_entropy)
    *(.text.ossl_drbg_clear_seed)
    *(.text.CRYPTO_secure_clear_free)
    *(.text.CRYPTO_secure_allocated)
    *(.text.ossl_x25519_public_from_private)
    *(.text.ge_scalarmult_base)
    *(.text.table_select)
    *(.text.cmov)
    *(.text.ge_madd)
    *(.text.fe_mul)
    *(.text.ge_p2_dbl)
    *(.text.fe_sq)
    *(.text.fe_invert)
    *(.text.fe_tobytes)
    *(.text.EVP_PKEY_get_octet_string_param)
    *(.text.OSSL_PARAM_set_octet_string)
    *(.text.ecx_gen_cleanup)
    *(.text.EVP_PKEY_derive_init)
    *(.text.EVP_PKEY_derive_init_ex)
    *(.text.EVP_KEYEXCH_free)
    *(.text.EVP_KEYEXCH_fetch)
    *(.text.evp_keyexch_up_ref)
    *(.text.EVP_KEYEXCH_up_ref)
    *(.text.EVP_KEYEXCH_get0_provider)
    *(.text.x25519_newctx)
    *(.text.x25519_init)
    *(.text.ossl_ecx_key_up_ref)
    *(.text.ossl_ecx_key_free)
    *(.text.EVP_PKEY_derive_set_peer)
    *(.text.EVP_PKEY_derive_set_peer_ex)
    *(.text.EVP_PKEY_public_check)
    *(.text.evp_keymgmt_validate)
    *(.text.x25519_validate)
    *(.text.ecx_set_peer)
    *(.text.EVP_PKEY_derive)
    *(.text.ecx_derive)
    *(.text.ossl_ecx_compute_key)
    *(.text.ossl_x25519)
    *(.text.x25519_scalar_mult)
    *(.text.fe51_mul)
    *(.text.fe51_sq)
    *(.text.ecx_freectx)
    *(.text.evp_keymgmt_util_clear_operation_cache)
    *(.text.evp_keymgmt_freedata)
    *(.text.ecx_free_key)
    *(.text.CRYPTO_THREAD_lock_free)
    *(.text.mlx_kem_freectx)
    *(.text.ssl_gensecret)
    *(.text.ssl_handshake_md)
    *(.text.ssl_get_algorithm2)
    *(.text.tls13_generate_secret)
    *(.text.EVP_MD_get0_name)
    *(.text.EVP_KDF_fetch)
    *(.text.evp_kdf_from_algorithm)
    *(.text.evp_kdf_up_ref)
    *(.text.evp_kdf_free)
    *(.text.ossl_ht_insert)
    *(.text.CRYPTO_atomic_store)
    *(.text.ossl_rcu_assign_uptr)
    *(.text.EVP_KDF_CTX_new)
    *(.text.kdf_hkdf_new)
    *(.text.EVP_KDF_up_ref)
    *(.text.EVP_KDF_free)
    *(.text.EVP_KDF_derive)
    *(.text.kdf_tls1_3_derive)
    *(.text.kdf_tls1_3_set_ctx_params)
    *(.text.hkdf_common_set_ctx_params)
    *(.text.ossl_prov_digest_load_from_params)
    *(.text.ossl_prov_digest_fetch)
    *(.text.ossl_prov_digest_md)
    *(.text.OSSL_PARAM_get_int32)
    *(.text.EVP_Q_mac)
    *(.text.EVP_MAC_fetch)
    *(.text.evp_mac_from_algorithm)
    *(.text.evp_mac_up_ref)
    *(.text.evp_mac_free)
    *(.text.EVP_MAC_settable_ctx_params)
    *(.text.EVP_MAC_get0_provider)
    *(.text.hmac_settable_ctx_params)
    *(.text.EVP_MAC_CTX_new)
    *(.text.hmac_new)
    *(.text.HMAC_CTX_new)
    *(.text.HMAC_CTX_reset)
    *(.text.EVP_MAC_up_ref)
    *(.text.EVP_MAC_CTX_set_params)
    *(.text.hmac_set_ctx_params)
    *(.text.EVP_MAC_init)
    *(.text.hmac_init)
    *(.text.hmac_setkey)
    *(.text.ossl_prov_digest_engine)
    *(.text.HMAC_Init_ex)
    *(.text.EVP_MD_get_block_size)
    *(.text.__memset_chk)
    *(.text.SHA384_Update)
    *(.text.SHA512_Update)
    *libcrypto-lib-sha512-armv8.o(.text)
    *(.text.EVP_MD_CTX_copy_ex)
    *(.text.sha384_dupctx)
    *(.text.EVP_MAC_update)
    *(.text.hmac_update)
    *(.text.HMAC_Update)
    *(.text.EVP_MAC_final)
    *(.text.EVP_MAC_CTX_get_mac_size)
    *(.text.hmac_get_ctx_params)
    *(.text.HMAC_size)
    *(.text.hmac_final)
    *(.text.HMAC_Final)
    *(.text.sha384_internal_final)
    *(.text.SHA512_Final)
    *(.text.sha384_copyctx)
    *(.text.hmac_free)
    *(.text.HMAC_CTX_free)
    *(.text.ossl_prov_digest_reset)
    *(.text.EVP_MAC_free)
    *(.text.EVP_KDF_CTX_free)
    *(.text.kdf_hkdf_free)
    *(.text.kdf_hkdf_reset)
    *(.text.tls13_generate_handshake_secret)
    *(.text.prov_tls13_hkdf_expand)
    *(.text.WPACKET_init_static_len)
    *(.text.HKDF_Expand)
    *(.text.tls_construct_stoc_psk)
    *(.text.ssl3_digest_cached_records)
    *(.text.tls_close_construct_packet)
    *(.text.WPACKET_get_length)
    *(.text.ssl3_handshake_write)
    *(.text.ssl3_do_write)
    *(.text.ssl3_write_bytes)
    *(.text.ssl_get_split_send_fragment)
    *(.text.SSL_get_state)
    *(.text.tls_get_max_records)
    *(.text.tls_get_max_records_default)
    *(.text.tls_write_records)
    *(.text.tls_write_records_default)
    *(.text.tls_allocate_write_buffers_default)
    *(.text.tls_setup_write_buffer)
    *(.text.tls_initialise_write_packets_default)
    *(.text.tls_prepare_record_header_default)
    *(.text.tls_any_prepare_for_encryption)
    *(.text.tls_post_encryption_processing_default)
    *(.text.tls_retry_write_records)
    *(.text.buffer_write)
    *(.text.buffer_write.part.0)
    *(.text.ossl_statem_server_post_work)
    *(.text.tls_construct_change_cipher_spec)
    *(.text.tls13_setup_key_block)
    *(.text.ssl_cipher_get_evp)
    *(.text.ssl_cipher_get_evp_cipher)
    *(.text.ssl_evp_cipher_up_ref)
    *(.text.EVP_CIPHER_get0_provider)
    *(.text.EVP_CIPHER_up_ref)
    *(.text.ssl_cipher_get_evp_md_mac)
    *(.text.EVP_CIPHER_get_flags)
    *(.text.ssl_evp_cipher_free)
    *(.text.ssl_evp_md_free)
    *(.text.tls13_store_handshake_traffic_hash)
    *(.text.ssl_handshake_hash)
    *(.text.tls13_change_cipher_state)
    *(.text.derive_secret_key_and_iv)
    *(.text.tls13_hkdf_expand)
    *(.text.tls13_hkdf_expand_ex)
    *(.text.EVP_CIPHER_is_a)
    *(.text.EVP_CIPHER_get_key_length)
    *(.text.EVP_CIPHER_get_mode)
    *(.text.EVP_CIPHER_get_iv_length)
    *(.text.tls13_derive_key)
    *(.text.tls13_derive_iv)
    *(.text.ssl_log_secret)
    *(.text.tls13_derive_finishedkey)
    *(.text.tls_set_plain_alerts)
    *(.text.tls13_set_crypto_state)
    *(.text.EVP_CIPHER_CTX_new)
    *(.text.ENGINE_get_cipher_engine)
    *(.text.EVP_CIPHER_free)
    *(.text.aes256gcm_newctx)
    *(.text.ossl_prov_aes_hw_gcm)
    *(.text.ossl_gcm_initctx)
    *(.text.ossl_gcm_einit)
    *(.text.ossl_gcm_set_ctx_params)
    *(.text.EVP_CIPHER_CTX_ctrl)
    *(.text.evp_do_ciph_ctx_setparams)
    *(.text.ossl_param_find_pidx)
    *(.text.evp_do_ciph_ctx_getparams)
    *(.text.ossl_gcm_get_ctx_params)
    *(.text.armv8_aes_gcm_initkey)
    *(.text.CRYPTO_gcm128_init)
    *libcrypto-lib-ghashv8-armx.o(.text)
    *(.text.ossl_gcm_dinit)
    *(.text.tls_construct_encrypted_extensions)
    *(.text.tls_construct_stoc_server_name)
    *(.text.tls_construct_stoc_maxfragmentlen)
    *(.text.tls_construct_stoc_supported_groups)
    *(.text.SSL_version)
    *(.text.tls_construct_stoc_alpn)
    *(.text.tls_construct_stoc_use_srtp)
    *(.text.tls_construct_stoc_client_cert_type)
    *(.text.tls_construct_stoc_server_cert_type)
    *(.text.tls_construct_stoc_early_data)
    *(.text.tls13_get_record_type)
    *(.text.tls13_add_record_padding)
    *(.text.tls_prepare_for_encryption_default)
    *(.text.tls13_cipher)
    *(.text.tls_increment_sequence_ctr)
    *(.text.EVP_CIPHER_CTX_get0_cipher)
    *(.text.ossl_gcm_stream_update)
    *(.text.gcm_cipher_internal)
    *(.text.ossl_gcm_setiv)
    *(.text.CRYPTO_gcm128_setiv)
    *(.text.ossl_gcm_aad_update)
    *(.text.CRYPTO_gcm128_aad)
    *(.text.generic_aes_gcm_cipher_update)
    *(.text.CRYPTO_gcm128_encrypt_ctr32)
    *(.text.EVP_CipherFinal_ex)
    *(.text.EVP_EncryptFinal_ex)
    *(.text.EVP_CIPHER_CTX_get_block_size)
    *(.text.EVP_CIPHER_get_block_size)
    *(.text.ossl_gcm_stream_final)
    *(.text.ossl_gcm_cipher_final)
    *(.text.CRYPTO_gcm128_tag)
    *(.text.CRYPTO_gcm128_finish)
    *(.text.send_certificate_request)
    *(.text.tls_construct_server_certificate)
    *(.text.ssl3_output_cert_chain)
    *(.text.ssl_security_cert_chain)
    *(.text.ssl_security_cert)
    *(.text.X509_get0_pubkey)
    *(.text.X509_PUBKEY_get0)
    *(.text.EVP_PKEY_get_security_bits)
    *(.text.ssl_add_cert_to_wpacket)
    *(.text.i2d_X509)
    *(.text.ASN1_item_i2d)
    *(.text.ASN1_item_ex_i2d)
    *(.text.ossl_asn1_enc_restore)
    *(.text.x509_cb)
    *(.text.ossl_asn1_do_adb)
    *(.text.ossl_asn1_get_const_field_ptr)
    *(.text.asn1_template_ex_i2d)
    *(.text.X509_CINF_it)
    *(.text.X509_ALGOR_it)
    *(.text.ASN1_OBJECT_it)
    *(.text.asn1_i2d_ex_primitive)
    *(.text.ASN1_object_size)
    *(.text.ASN1_ANY_it)
    *(.text.ASN1_BIT_STRING_it)
    *(.text.ossl_i2c_ASN1_BIT_STRING)
    *(.text.WPACKET_sub_allocate_bytes__)
    *(.text.ASN1_put_object)
    *(.text.tls_construct_stoc_status_request)
    *(.text.tls_construct_cert_verify)
    *(.text.get_cert_verify_tbs_data.constprop.0)
    *(.text.EVP_DigestSign)
    *(.text.EVP_DigestSignFinal)
    *(.text.ecdsa_digest_sign_final)
    *(.text.ECDSA_size)
    *(.text.EC_GROUP_get0_order)
    *(.text.i2d_ECDSA_SIG)
    *(.text.WPACKET_init_null)
    *(.text.ossl_encode_der_dsa_sig)
    *(.text.WPACKET_is_null_buf)
    *(.text.ossl_encode_der_integer)
    *(.text.BN_is_negative)
    *(.text.ossl_encode_der_length)
    *(.text.EVP_DigestSignUpdate)
    *(.text.ecdsa_digest_signverify_update)
    *(.text.SHA256_Update)
    *libcrypto-lib-sha256-armv8.o(.text)
    *(.text.EVP_PKEY_CTX_dup)
    *(.text.ecdsa_dupctx)
    *(.text.sha256_dupctx)
    *(.text.sha256_internal_final)
    *(.text.SHA256_Final)
    *(.text.ECDSA_sign_ex)
    *(.text.ossl_ecdsa_sign)
    *(.text.ECDSA_do_sign_ex)
    *(.text.ossl_ecdsa_sign_sig)
    *(.text.ossl_ecdsa_simple_sign_sig)
    *(.text.EC_KEY_can_sign)
    *(.text.ECDSA_SIG_new)
    *(.text.BN_new)
    *(.text.BN_bin2bn)
    *(.text.bin2bn)
    *(.text.bn_wexpand)
    *(.text.bn_expand2)
    *(.text.BN_get_flags)
    *(.text.bn_correct_top)
    *(.text.ecdsa_sign_setup)
    *(.text.BN_secure_new)
    *(.text.EC_POINT_new)
    *(.text.ossl_ec_GFp_simple_point_init)
    *(.text.BN_set_bit)
    *(.text.ossl_bn_gen_dsa_nonce_fixed_top)
    *(.text.ossl_bn_get_libctx)
    *(.text.BN_bn2binpad)
    *(.text.bn2binpad)
    *(.text.sha512_newctx)
    *(.text.sha512_internal_init)
    *(.text.SHA512_Init)
    *(.text.sha512_internal_final)
    *(.text.BN_set_flags)
    *(.text.ossl_bn_mask_bits_fixed_top)
    *(.text.BN_ucmp)
    *(.text.sha512_freectx)
    *(.text.ossl_bn_is_word_fixed_top)
    *(.text.EC_POINT_mul)
    *(.text.ecp_nistz256_points_mul)
    *(.text.EC_GROUP_get0_generator)
    *(.text.ecp_nistz256_is_affine_G)
    *(.text.bn_get_top)
    *(.text.bn_get_words)
    *libcrypto-lib-ecp_nistz256-armv8.o(.text)
    *(.text.bn_set_words)
    *(.text.EC_POINT_get_affine_coordinates)
    *(.text.EC_POINT_is_at_infinity)
    *(.text.ossl_ec_GFp_simple_is_at_infinity)
    *(.text.ecp_nistz256_get_affine)
    *(.text.bn_copy_words)
    *(.text.BN_nnmod)
    *(.text.BN_div)
    *(.text.bn_div_fixed_top)
    *(.text.BN_CTX_get)
    *(.text.bn_init)
    *(.text.BN_zero_ex)
    *(.text.BN_copy)
    *(.text.bn_lshift_fixed_top)
    *(.text.bn_div_words)
    *(.text.bn_mul_words)
    *(.text.bn_sub_words)
    *(.text.bn_add_words)
    *(.text.bn_rshift_fixed_top)
    *(.text.ossl_ec_group_do_inverse_ord)
    *(.text.ecp_nistz256_inv_mod_ord)
    *(.text.EC_POINT_free)
    *(.text.ossl_ec_GFp_simple_point_finish)
    *(.text.bn_to_mont_fixed_top)
    *(.text.bn_mul_mont_fixed_top)
    *libcrypto-lib-armv8-mont.o(.text)
    *(.text.bn_mod_add_fixed_top)
    *(.text.BN_mod_mul_montgomery)
    *(.text.ECDSA_SIG_free)
    *(.text.tls_construct_finished)
    *(.text.tls13_final_finish_mac)
    *(.text.statem_flush)
    *(.text.sock_write)
    *(.text.BIO_copy_next_retry)
    *(.text.BIO_test_flags)
    *(.text.BIO_set_flags)
    *(.text.tls13_generate_master_secret)
    *(.text.tls13_store_server_finished_hash)
    *(.text.EVP_CIPHER_CTX_reset)
    *(.text.aes_gcm_freectx)
    *(.text.mem_read)
    *(.text.BIO_sock_should_retry)
    *(.text.BIO_sock_non_fatal_error)
    *(.text.ossl_statem_fatal)
    *(.text.ossl_statem_send_fatal)
    *(.text.ssl3_send_alert)
    *(.text.tls13_alert_code)
    *(.text.tls1_alert_code)
    *(.text.SSL_CTX_remove_session)
    *(.text.RECORD_LAYER_write_pending)
    *(.text.ssl3_dispatch_alert)
    *(.text.SSL_get_error)
    *(.text.ossl_ssl_get_error)
    *(.text.ERR_peek_error)
    *(.text.SSL_shutdown)
    *(.text.SSL_free)
    *(.text.ossl_ssl_connection_free)
    *(.text.BIO_pop)
    *(.text.buffer_free)
    *(.text.X509_VERIFY_PARAM_free)
    *(.text.OSSL_STACK_OF_X509_free)
    *(.text.ssl_cert_free)
    *(.text.ssl_cert_clear_certs)
    *(.text.ossl_asn1_do_lock)
    *(.text.X509_STORE_free)
    *(.text.custom_exts_free)
    *(.text.SSL_CTX_free)
    *(.text.SCT_LIST_free)
    *(.text.tls1_free)
    *(.text.ssl3_free)
    *(.text.mlx_kem_key_free)
    *(.text.ml_kem_free_key)
    *(.text.ossl_ml_kem_key_free)
    *(.text.ossl_ml_kem_key_reset)
    *(.text.ossl_quic_tls_free)
    *(.text.ssl_srp_ctx_free_intern)
    *(.text.ASYNC_WAIT_CTX_free)
    *(.text.sock_free)
    *(.text.SSL_want)
    *(.text.tls13_validate_record_header)
    *(.text.EVP_DecryptUpdate)
    *(.text.CRYPTO_gcm128_decrypt_ctr32)
    *(.text.EVP_DecryptFinal_ex)
    *(.text.tls13_post_process_record)
    *(.text.tls13_common_post_process_record)
    *(.text.ssl3_take_mac)
    *(.text.tls_process_finished)
    *(.text.tls13_save_handshake_digest_for_pha)
    *(.text.tls_finish_handshake)
    *(.text.tls_construct_new_session_ticket)
    *(.text.ssl_generate_session_id)
    *(.text.def_generate_session_id)
    *(.text.SSL_has_matching_session_id)
    *(.text.lh_SSL_SESSION_hfn_thunk)
    *(.text.ssl_session_hash)
    *(.text.i2d_SSL_SESSION)
    *(.text.UINT32_it)
    *(.text.uint32_i2c)
    *(.text.ossl_i2c_uint64_int)
    *(.text.INT32_it)
    *(.text.ASN1_OCTET_STRING_it)
    *(.text.ZINT64_it)
    *(.text.uint64_i2c)
    *(.text.ZINT32_it)
    *(.text.ZUINT64_it)
    *(.text.ZUINT32_it)
    *(.text.ssl_hmac_new)
    *(.text.d2i_SSL_SESSION_ex)
    *(.text.ASN1_item_d2i)
    *(.text.ASN1_item_d2i_ex)
    *(.text.asn1_item_embed_d2i)
    *(.text.asn1_check_tlen)
    *(.text.ASN1_get_object)
    *(.text.ossl_asn1_item_ex_new_intern)
    *(.text.asn1_item_embed_new)
    *(.text.ossl_asn1_enc_init)
    *(.text.ossl_asn1_get_field_ptr)
    *(.text.asn1_template_new)
    *(.text.asn1_primitive_new)
    *(.text.uint32_clear)
    *(.text.ASN1_STRING_type_new)
    *(.text.uint64_clear)
    *(.text.asn1_template_ex_d2i)
    *(.text.asn1_template_noexp_d2i)
    *(.text.asn1_d2i_ex_primitive)
    *(.text.uint32_c2i)
    *(.text.ossl_c2i_uint64_int)
    *(.text.c2i_ibuf)
    *(.text.ASN1_STRING_set)
    *(.text.ossl_asn1_template_free)
    *(.text.ossl_asn1_primitive_free)
    *(.text.uint64_c2i)
    *(.text.ossl_asn1_enc_save)
    *(.text.ossl_asn1_enc_free)
    *(.text.ossl_asn1_string_embed_free)
    *(.text.EVP_CIPHER_fetch)
    *(.text.evp_cipher_up_ref)
    *(.text.EVP_EncryptInit_ex)
    *(.text.aes_256_cbc_newctx)
    *(.text.ossl_prov_cipher_hw_aes_cbc)
    *(.text.ossl_cipher_generic_initkey)
    *(.text.ossl_cipher_generic_get_ctx_params)
    *(.text.ssl_hmac_init)
    *(.text.create_ticket_prequel)
    *(.text.ossl_cipher_hw_generic_cbc)
    *(.text.ossl_cipher_trailingdata)
    *(.text.ossl_cipher_generic_block_final)
    *(.text.ossl_cipher_padblock)
    *(.text.ssl_hmac_update)
    *(.text.ssl_hmac_final)
    *(.text.sha256_copyctx)
    *(.text.aes_freectx)
    *(.text.ossl_cipher_generic_reset_ctx)
    *(.text.ssl_hmac_free)
    *(.text.ssl_hmac_old_free)
    *(.text.ssl_update_cache)
    *(.text.ssl_session_dup)
    *(.text.ssl_session_dup_intern)
    *(.text.CRYPTO_dup_ex_data)
    *(.text.SSL_get0_alpn_selected)
    *(.text.SSL_read)
    *(.text.ssl_read_internal)
    *(.text.ssl3_read)
    *(.text.SSL_write)
    *(.text.ssl_write_internal)
    *(.text.ssl3_write)
    *(.text.CRYPTO_gcm128_encrypt)
    *(.text.armv8_aes_gcm_encrypt)
    *libcrypto-lib-aes-gcm-armv8_64.o(.text)
    *(.text.BIO_set_callback_arg)
    *(.text.BIO_set_callback_ex)
    *(.text.server.tls.socketReadCallback)
    *(.text.BIO_get_callback_arg)
    *(.text.SSL_has_pending)
    *(.text.RECORD_LAYER_read_pending)
    *(.text.tls_unprocessed_read_pending)
    *(.text.server.filecache.Cache.revalidate)
    *(.text.tls_parse_ctos_alpn)
    *(.text.server.tls.alpn)
    *(.text.SSL_get_SSL_CTX)
    *(.text.zhttp_tx_attach)
    *(.text.zhttp_h2_new)
    *(.text.zhttp_tx_attached)
    *(.text.nghttp2_session_callbacks_new)
    *(.text.nghttp2_option_new)
    *(.text.nghttp2_session_callbacks_set_on_begin_headers_callback)
    *(.text.nghttp2_session_callbacks_set_on_header_callback)
    *(.text.nghttp2_session_callbacks_set_on_invalid_header_callback)
    *(.text.nghttp2_session_callbacks_set_on_frame_recv_callback)
    *(.text.nghttp2_session_callbacks_set_on_data_chunk_recv_callback)
    *(.text.nghttp2_session_callbacks_set_on_stream_close_callback)
    *(.text.nghttp2_session_callbacks_set_send_callback2)
    *(.text.nghttp2_session_callbacks_set_send_data_callback)
    *(.text.nghttp2_option_set_no_auto_window_update)
    *(.text.nghttp2_session_server_new2)
    *(.text.session_new)
    *(.text.nghttp2_mem_default)
    *(.text.nghttp2_mem_calloc)
    *(.text.default_calloc)
    *(.text.nghttp2_ratelim_init)
    *(.text.nghttp2_hd_deflate_init2)
    *(.text.nghttp2_mem_malloc)
    *(.text.default_malloc)
    *(.text.nghttp2_hd_inflate_init)
    *(.text.nghttp2_buf_init)
    *(.text.nghttp2_bufs_init3)
    *(.text.nghttp2_mem_realloc)
    *(.text.default_realloc)
    *(.text.nghttp2_map_init)
    *(.text.nghttp2_outbound_item_free)
    *(.text.nghttp2_mem_free)
    *(.text.default_free)
    *(.text.nghttp2_bufs_reset)
    *(.text.session_inbound_frame_reset)
    *(.text.nghttp2_buf_wrap_init)
    *(.text.nghttp2_buf_free)
    *(.text.nghttp2_pq_init)
    *(.text.nghttp2_submit_settings)
    *(.text.nghttp2_session_add_settings)
    *(.text.nghttp2_iv_check)
    *(.text.nghttp2_frame_iv_copy)
    *(.text.nghttp2_outbound_item_init)
    *(.text.nghttp2_frame_settings_init)
    *(.text.nghttp2_session_add_item)
    *(.text.nghttp2_map_find)
    *(.text.nghttp2_outbound_queue_push)
    *(.text.server.multiplex.driveH2)
    *(.text.zhttp_h2_drive)
    *(.text.nghttp2_session_mem_recv2)
    *(.text.session_mem_recv)
    *(.text.nghttp2_map_size)
    *(.text.nghttp2_cpymem)
    *(.text.nghttp2_frame_unpack_frame_hd)
    *(.text.nghttp2_get_uint32)
    *(.text.nghttp2_buf_reset)
    *(.text.nghttp2_frame_unpack_settings_entry)
    *(.text.nghttp2_get_uint16)
    *(.text.nghttp2_frame_unpack_settings_payload)
    *(.text.nghttp2_session_on_settings_received)
    *(.text.nghttp2_map_each)
    *(.text.session_is_closing)
    *(.text.h2_frame)
    *(.text.nghttp2_frame_settings_free)
    *(.text.nghttp2_frame_unpack_window_update_payload)
    *(.text.nghttp2_session_on_window_update_received)
    *(.text.nghttp2_frame_window_update_free)
    *(.text.nghttp2_frame_priority_len)
    *(.text.session_process_headers_frame)
    *(.text.nghttp2_frame_unpack_headers_payload)
    *(.text.nghttp2_priority_spec_default_init)
    *(.text.nghttp2_session_on_request_headers_received)
    *(.text.nghttp2_session_open_stream)
    *(.text.nghttp2_stream_init)
    *(.text.nghttp2_map_insert)
    *(.text.h2_begin)
    *(.text.nghttp2_frame_trail_padlen)
    *(.text.nghttp2_hd_inflate_hd_nv)
    *(.text.nghttp2_rcbuf_decref)
    *(.text.hd_inflate_read_len)
    *(.text.nghttp2_http_on_header)
    *(.text.nghttp2_check_method)
    *(.text.h2_header)
    *(.text.nghttp2_hd_huff_decode_context_init)
    *(.text.nghttp2_rcbuf_new)
    *(.text.nghttp2_hd_huff_decode)
    *(.text.nghttp2_hd_huff_decode_failure_state)
    *(.text.hd_inflate_commit_indname)
    *(.text.nghttp2_rcbuf_incref)
    *(.text.add_hd_table_incremental)
    *(.text.nghttp2_check_path)
    *(.text.nghttp2_mem_free2)
    *(.text.nghttp2_check_nonempty_header_name)
    *(.text.nghttp2_check_header_value_rfc9113)
    *(.text.nghttp2_hd_inflate_end_headers)
    *(.text.nghttp2_http_on_request_headers)
    *(.text.nghttp2_http_on_remote_end_stream)
    *(.text.server.multiplex.openH2)
    *(.text.server.multiplex.openStreamAddr)
    *(.text.nghttp2_stream_shutdown)
    *(.text.nghttp2_frame_headers_free)
    *(.text.flush_h2)
    *(.text.server.multiplex.driveRequest)
    *(.text.zhttp_stream_read)
    *(.text.http.request.ChunkedDecoder.feed)
    *(.text.server.conn.Conn.storeBody)
    *(.text.zhttp_stream_write)
    *(.text.zhttp_stream_finish)
    *(.text.response_headers)
    *(.text.nghttp2_submit_response2)
    *(.text.nghttp2_data_provider_wrap_v2)
    *(.text.nghttp2_data_provider_wrap_contains_read_callback)
    *(.text.nghttp2_nv_array_copy)
    *(.text.nghttp2_downcase)
    *(.text.nghttp2_frame_headers_init)
    *(.text.nghttp2_session_resume_data)
    *(.text.nghttp2_stream_check_deferred_item)
    *(.text.nghttp2_session_send)
    *(.text.nghttp2_session_mem_send_internal)
    *(.text.nghttp2_outbound_queue_pop)
    *(.text.nghttp2_frame_pack_settings)
    *(.text.nghttp2_put_uint32be)
    *(.text.nghttp2_put_uint16be)
    *(.text.h2_send)
    *(.text.session_after_frame_sent1)
    *(.text.session_after_frame_sent2)
    *(.text.nghttp2_hd_deflate_bound)
    *(.text.nghttp2_frame_pack_headers)
    *(.text.nghttp2_hd_deflate_hd_bufs)
    *(.text.lookup_token)
    *(.text.nghttp2_bufs_add)
    *(.text.nghttp2_rcbuf_new2)
    *(.text.emit_indname_block)
    *(.text.emit_string)
    *(.text.nghttp2_hd_huff_encode_count)
    *(.text.nghttp2_hd_huff_encode)
    *(.text.nghttp2_bufs_addb)
    *(.text.nghttp2_bufs_len)
    *(.text.frame_pack_headers_shared.isra.0)
    *(.text.session_headers_add_pad)
    *(.text.nghttp2_frame_add_pad)
    *(.text.nghttp2_bufs_next_present)
    *(.text.nghttp2_submit_data_shared)
    *(.text.nghttp2_frame_data_init)
    *(.text.nghttp2_stream_attach_item)
    *(.text.session_ob_data_push)
    *(.text.nghttp2_pq_empty)
    *(.text.nghttp2_pq_push)
    *(.text.nghttp2_pq_top)
    *(.text.stream_less)
    *(.text.nghttp2_session_pack_data)
    *(.text.h2_read)
    *(.text.nghttp2_frame_pack_frame_hd)
    *(.text.nghttp2_stream_detach_item)
    *(.text.nghttp2_pq_remove)
    *(.text.bubble_down)
    *(.text.nghttp2_session_close_stream)
    *(.text.h2_close)
    *(.text.nghttp2_map_remove)
    *(.text.nghttp2_stream_free)
    *(.text.nghttp2_frame_data_free)
    *(.text.sweep)
    *(.text.nghttp2_session_want_read)
    *(.text.nghttp2_session_update_local_settings)
    *(.text.zhttp_h2_free)
    *(.text.nghttp2_session_del)
    *(.text.nghttp2_pq_free)
    *(.text.nghttp2_map_free)
    *(.text.nghttp2_hd_deflate_free)
    *(.text.nghttp2_hd_inflate_free)
    *(.text.nghttp2_bufs_free)
    *(.text.udp.Socket.receive)
    *(.text.endpoint.Endpoint.lookup)
    *(.text.crypto.Keys.init)
    *(.text.EVP_aes_128_gcm)
    *(.text.aes128gcm_newctx)
    *(.text.conn.Conn.issueCid)
    *(.text.RAND_bytes)
    *(.text.hash_map.Custom?u64?*conn.Conn?hash_map.AutoContext?u64??80?.grow)
    *(.text.SSL_set_quic_tls_cbs)
    *(.text.SSL_is_tls)
    *(.text.ossl_quic_tls_new)
    *(.text.ossl_quic_tls_configure)
    *(.text.SSL_ctrl)
    *(.text.ossl_ctrl_internal)
    *(.text.ssl_check_allowed_versions)
    *(.text.ssl_set_version_bound)
    *(.text.BIO_s_null)
    *(.text.SSL_clear_options)
    *(.text.ossl_ssl_set_custom_record_layer)
    *(.text.ossl_tls_add_custom_ext_intern)
    *(.text.SSL_extension_supported)
    *(.text.custom_ext_find)
    *(.text.quic_new_record_layer)
    *(.text.quic_set_first_handshake)
    *(.text.h3.Server.sslCreated)
    *(.text.h3.Handler.noopSsl)
    *(.text.SSL_set_quic_tls_transport_params)
    *(.text.ossl_quic_tls_set_transport_params)
    *(.text.crypto.Hp.mask)
    *(.text.crypto.ossl.Aead.open)
    *(.text.CRYPTO_gcm128_decrypt)
    *(.text.armv8_aes_gcm_decrypt)
    *(.text.stream.RecvBuf.insert)
    *(.text.ranges.RangeSet?16?.add)
    *(.text.conn.Conn.driveTls)
    *(.text.quic_free)
    *(.text.null_ctrl)
    *(.text.quic_set1_bio)
    *(.text.quic_read_record)
    *(.text.crypto_recv_rcd_cb)
    *(.text.conn.Conn.cryptoRecv)
    *(.text.quic_processed_read_pending)
    *(.text.quic_release_record)
    *(.text.crypto_release_rcd_cb)
    *(.text.conn.Conn.cryptoRelease)
    *(.text.ranges.RangeSet?32?.add)
    *(.text.quic_set_protocol_version)
    *(.text.custom_ext_parse)
    *(.text.parse_transport_params_cb)
    *(.text.got_transport_params_cb)
    *(.text.conn.Conn.gotParams)
    *(.text.quic_get_max_records)
    *(.text.quic_write_records)
    *(.text.crypto_send_cb)
    *(.text.conn.Conn.cryptoSend)
    *(.text.stream.SendBuf.write)
    *(.text.quic_set_plain_alerts)
    *(.text.yield_secret_cb)
    *(.text.conn.Conn.yieldSecret)
    *(.text.SSL_get_pending_cipher)
    *(.text.SSL_CIPHER_get_protocol_id)
    *(.text.EVP_aes_256_gcm)
    *(.text.add_transport_params_cb)
    *(.text.free_transport_params_cb)
    *(.text.heap.c_allocator_impl.free)
    *(.text.endpoint.Endpoint.flushConn)
    *(.text.recovery.FrameLog.push)
    *(.text.stream.SendBuf.onSent)
    *(.text.crypto.ossl.Aead.seal)
    *(.text.recovery.SentRing.push)
    *(.text.conn.Conn.lossTimer)
    *(.text.array_list.Aligned?*conn.Conn?null?.append)
    *(.text.udp.Socket.sendCb)
    *(.text.conn.Conn.ackRange)
    *(.text.stream.SendBuf.onAck)
    *(.text.recovery.Rtt.update)
    *(.text.conn.Conn.detectLoss)
    *(.text.conn.Conn.releaseLog)
    *(.text.crypto.Keys.next)
    *(.text.h3.Server.connReady)
    *(.text.conn.Conn.newStream)
    *(.text.conn.Space.deinit)
    *(.text.conn.Conn.discardSpace)
    *(.text.endpoint.Endpoint.unregisterOdcid)
    *(.text.conn.Conn.peerStream)
    *(.text.h3.Server.streamOpen)
    *(.text.h3.Server.streamReadable)
    *(.text.conn.Stream.consume)
    *(.text.h3.peekFrame)
    *(.text.h3.Request.nextFrame)
    *(.text.h3.Request.collectBlock)
    *(.text.qpack.Decoder.next)
    *(.text.qpack.Decoder.string__func_1448)
    *(.text.qpack.HuffCache.get)
    *(.text.qpack.huffDecode)
    *(.text.server.h3.onRequest)
    *(.text.server.h3_head.token)
    *(.text.h3.Request.ended)
    *(.text.server.h3.read)
    *(.text.server.h3.emitHead)
    *(.text.server.h3.readChunk)
    *(.text.h3.Request.read)
    *(.text.h3.Request.cutShort)
    *(.text.fmt.parseInt__func_1087)
    *(.text.server.h3_head.hopHeader)
    *(.text.h3.Request.sendHeaders)
    *(.text.conn.Stream.reserve)
    *(.text.qpack.Encoder.status)
    *(.text.qpack.Encoder.field)
    *(.text.conn.Stream.commit)
    *(.text.server.h3.finish)
    *(.text.h3.Request.release)
    *(.text.conn.Stream.release)
    *(.text.server.h3.recycle)
    *(.text.conn.Conn.retireStream)
    *(.text.hash_map.Custom?u64?*conn.Stream?hash_map.AutoContext?u64??80?.get)
    *(.text.conn.Stream.reset)
    *(.text.h3.Server.streamReset)
    *(.text.h3.Session.shutdown)
    *(.text.conn.Conn.startClose)
    *(.text.h3.Server.connClosed)
    *(.text.server.filecache.openUncached)
    *(.text.server.filecache.Cache.mapFile)
    *(.text.server.net.sendFile)
    *(.text.server.tls.flushWrites)
    *(.text.zhttp_stream_file)
    *(.text.heap.PageAllocator.alloc)
    *(.text.h2_send_data)
    *(.text.finish_buffered_h2)
    *(.text.update_local_initial_window_size_func)
    *(.text.nghttp2_stream_update_local_initial_window_size)
    *(.text.session_update_consumed_size)
    *(.text.nghttp2_should_send_window_update)
    *(.text.nghttp2_stream_defer_item)
    *(.text.nghttp2_stream_resume_deferred_item)
    *(.text.h3.Server.streamWritable)
    *(.text.server.h3.onReadable)
    *(.text.endpoint.Endpoint.heapRemove)
    *(.text.conn.Conn.unregisterCids)
    *(.text.conn.Conn.destroy)
    *(.text.OSSL_ERR_STATE_free)
    *(.text.server.handler.finalizeExtra)
    *(.text.http.response.writeDefaultPage)
    *(.text.server.handler.writeSimpleLoc)
    *(.text.ssl3_shutdown)
    *(.text.tls_parse_ctos_psk)
    *(.text.tls_decrypt_ticket)
    *(.text.EVP_DecryptInit_ex)
    *(.text.ossl_cipher_generic_dinit)
    *(.text.ssl_hmac_size)
    *(.text.ossl_cipher_unpadblock)
    *(.text.tls_psk_do_binder)
    *(.text.EVP_PKEY_new_raw_private_key_ex)
    *(.text.mac_new)
    *(.text.ossl_mac_key_new)
    *(.text.mac_import)
    *(.text.mac_key_fromdata)
    *(.text.mac_get_params)
    *(.text.mac_hmac_newctx)
    *(.text.mac_digest_sign_init)
    *(.text.ossl_mac_key_up_ref)
    *(.text.ossl_mac_key_free)
    *(.text.ossl_prov_set_macctx)
    *(.text.mac_digest_sign_update)
    *(.text.mac_dupctx)
    *(.text.EVP_MAC_CTX_dup)
    *(.text.hmac_dup)
    *(.text.HMAC_CTX_copy)
    *(.text.ossl_prov_digest_copy)
    *(.text.mac_digest_sign_final)
    *(.text.mac_freectx)
    *(.text.mac_free)
    *(.text.ossl_prov_cipher_reset)
    *(.text.fmt.parseInt__func_230)
    *(.text.http.request.parseDecimal__func_1090)
    *(.text.main.workerSignal)
    *(.text.server.multiplex.freeH3)
    *(.text.h3.Server.deinit)
    *(.text.OPENSSL_cleanup)
    *(.text.OPENSSL_thread_stop)
    *(.text.CRYPTO_THREAD_set_local)
    *(.text.init_thread_stop.part.0)
    *(.text.rand_delete_thread_state)
    *(.text.EVP_RAND_CTX_free)
    *(.text.drbg_ctr_free)
    *(.text.ossl_rand_drbg_free)
    *(.text.EVP_RAND_free)
    *(.text.err_delete_thread_state)
    *(.text.init_thread_remove_handlers)
    *(.text.OPENSSL_sk_delete)
    *(.text.CRYPTO_THREAD_cleanup_local)
    *(.text.ossl_comp_zlib_cleanup)
    *(.text.ossl_comp_brotli_cleanup)
    *(.text.ossl_comp_zstd_cleanup)
    *(.text.ossl_rand_cleanup_int)
    *(.text.RAND_set_rand_method)
    *(.text.ossl_rand_pool_cleanup)
    *(.text.ossl_release_default_drbg_ctx)
    *(.text.ossl_rand_ctx_free)
    *(.text.seed_src_free)
    *(.text.ossl_config_modules_free)
    *(.text.CONF_modules_unload)
    *(.text.conf_modules_finish_int)
    *(.text.do_init_module_list_lock_ossl_)
    *(.text.ossl_rcu_lock_new)
    *(.text.ossl_rcu_write_lock)
    *(.text.ossl_rcu_write_unlock)
    *(.text.ossl_synchronize_rcu)
    *(.text.__aarch64_ldadd8_rel)
    *(.text.ossl_rcu_lock_free)
    *(.text.engine_cleanup_int)
    *(.text.ossl_store_destroy_loaders_int)
    *(.text.OPENSSL_LH_free)
    *(.text.ossl_lib_ctx_default_deinit)
    *(.text.ossl_ctx_thread_stop)
    *(.text.context_deinit_objs)
    *(.text.ossl_method_store_free)
    *(.text.ossl_sa_doall_arg)
    *(.text.alg_cleanup)
    *(.text.impl_free)
    *(.text.evp_cipher_free)
    *(.text.evp_cipher_free_int)
    *(.text.ossl_provider_free)
    *(.text.OPENSSL_LH_doall)
    *(.text.OPENSSL_LH_flush)
    *(.text.lh_QUERY_doall_thunk)
    *(.text.impl_cache_free)
    *(.text.evp_md_free)
    *(.text.evp_md_free_int)
    *(.text.evp_keymgmt_free)
    *(.text.evp_signature_free)
    *(.text.evp_keyexch_free)
    *(.text.evp_rand_free)
    *(.text.ossl_sa_free)
    *(.text.ossl_prov_conf_ctx_free)
    *(.text.ossl_decoder_free)
    *(.text.OSSL_DECODER_free)
    *(.text.ossl_decoder_cache_free)
    *(.text.lh_DECODER_CACHE_ENTRY_doall_thunk)
    *(.text.decoder_cache_entry_free)
    *(.text.OSSL_DECODER_CTX_free)
    *(.text.decoder_clean_pkey_construct_arg)
    *(.text.ossl_decoder_instance_free)
    *(.text.der2key_freectx)
    *(.text.spki2typespki_freectx)
    *(.text.epki2pki_freectx)
    *(.text.pem2der_freectx)
    *(.text.ossl_pw_clear_passphrase_data)
    *(.text.ossl_pw_clear_passphrase_cache)
    *(.text.ossl_provider_store_free)
    *(.text.provider_deactivate_free)
    *(.text.ossl_provider_deactivate)
    *(.text.provider_deactivate)
    *(.text.ossl_decoder_cache_flush)
    *(.text.provider_remove_store_methods)
    *(.text.ossl_property_string_data_free)
    *(.text.lh_PROPERTY_STRING_doall_thunk)
    *(.text.property_free)
    *(.text.ossl_stored_namemap_free)
    *(.text.ossl_namemap_free)
    *(.text.names_free)
    *(.text.name_string_free)
    *(.text.ossl_ht_free)
    *(.text.ossl_ht_write_lock)
    *(.text.ossl_ht_flush_internal)
    *(.text.CRYPTO_aligned_alloc)
    *(.text.ossl_rcu_cb_item_new)
    *(.text.ossl_rcu_call)
    *(.text.ossl_ht_write_unlock)
    *(.text.free_oldmd)
    *(.text.internal_free_nop)
    *(.text.ossl_property_defns_free)
    *(.text.lh_PROPERTY_DEFN_ELEM_doall_thunk)
    *(.text.property_defn_free)
    *(.text.ossl_ctx_global_properties_free)
    *(.text.ossl_bio_core_globals_free)
    *(.text.ossl_prov_drbg_nonce_ctx_free)
    *(.text.ossl_indicator_set_callback_free)
    *(.text.ossl_self_test_set_callback_free)
    *(.text.ossl_threads_ctx_free)
    *(.text.ossl_crypto_mutex_free)
    *(.text.ossl_crypto_condvar_free)
    *(.text.ossl_child_prov_ctx_free)
    *(.text.ossl_free_compression_methods_int)
    *(.text.ossl_crypto_cleanup_all_ex_data_int)
    *(.text.cleanup_cb)
    *(.text.ossl_cleanup_thread)
    *(.text.bio_cleanup)
    *(.text.bio_sock_cleanup_int)
    *(.text.evp_cleanup_int)
    *(.text.OBJ_NAME_cleanup)
    *(.text.OPENSSL_LH_get_down_load)
    *(.text.OPENSSL_LH_set_down_load)
    *(.text.lh_OBJ_NAME_doall_thunk)
    *(.text.names_lh_free_doall)
    *(.text.OBJ_NAME_remove)
    *(.text.OBJ_NAME_init)
    *(.text.OPENSSL_LH_delete)
    *(.text.lh_OBJ_NAME_hfn_thunk)
    *(.text.obj_name_hash)
    *(.text.ossl_lh_strcasehash)
    *(.text.lh_OBJ_NAME_cfn_thunk)
    *(.text.obj_name_cmp)
    *(.text.EVP_PBE_cleanup)
    *(.text.OBJ_sigid_free)
    *(.text.evp_app_cleanup_int)
    *(.text.ossl_obj_cleanup_int)
    *(.text.err_cleanup)
    *(.text.CRYPTO_secure_malloc_done)
    *(.text.OSSL_CMP_log_close)
    *(.text.OSSL_trace_set_channel)
    *(.text.ossl_trace_cleanup)
    *(.text.config_watch.Sources.scan)
    *(.text.config_watch.fingerprint)
    *(.text.main.retryEncryptedCleanup)
    *(.text.main.masterSignal)
    *(.text.main.removePid)
    *(.text.config_watch.Sources.deinit)
    *(.text.http.diag.Diag.deinit)
    *(.text.process.Environ.Map.deinit)
    *(.text.heap.PageAllocator.free)
    *(.text.fs.path.resolveAlloc)
    *(.text.array_list.Aligned?u8?null?.appendSlice)
    *(.text.acme.migrationPending)
    *(.text.os.releaseStartupPages)
    *(.text.load_balancer.Settings.validate)
    *(.text.main.spawnWorker)
    *(.text.server.worker.Worker.run)
    *(.text.crypto.ghash_polyval.Hash?.big?true?.blocks)
    *(.text.endpoint.Sink.discard)
    *(.text.server.h3.onAborted)
    *(.text.server.h3.reject)
    *(.text.server.filecache.Cache.deinit)
    *(.text.fmt.parseInt__func_914)
    *(.text.main.writePid)
    *(.text.__multf3)
    *(.text.compiler_rt.mulf3.__multf3)
    *(.text.__subtf3)
    *(.text.compiler_rt.addf3.__subtf3)
    *(.text.compiler_rt.addf3.add_f128)
    *(.text.__addtf3)
    *(.text.compiler_rt.addf3.__addtf3)
    *(.text.__getf2)
    *(.text.__gttf2)
    *(.text.compiler_rt.comparef.__getf2)
    *(.text.__cmptf2)
    *(.text.__eqtf2)
    *(.text.__letf2)
    *(.text.__lttf2)
    *(.text.__netf2)
    *(.text.compiler_rt.comparef.__cmptf2)
    *(.text.__floatuntitf)
    *(.text.compiler_rt.float_from_int.__floatuntitf)
    *(.text.__fixtfti)
    *(.text.compiler_rt.int_from_float.__fixtfti)
    *(.text.compiler_rt.udivmod.udivmod__func_187)
    *(.text.__divti3)
    *(.text.compiler_rt.udivmod.__divti3)
    *(.text.RAND_priv_bytes)
    *(.text.ossl_rand_ctx_new)
    *(.text.ossl_rand_get0_seed_noncreating)
    *(.text.RAND_get0_primary)
    *(.text.RAND_get0_public)
    *(.text.RAND_get0_private)
    *(.text.ossl_random_add_conf_module)
    *(.text.RAND_set1_random_provider)
    *(.text.random_conf_init)
    *(.text.ossl_rand_check_random_provider_on_load)
    *(.text.ossl_rand_check_random_provider_on_unload)
    *(.text.cleanup_shm)
    *(.text.wait_random_seeded)
    *(.text.ossl_rand_pool_init)
    *(.text.ossl_pool_acquire_entropy)
    *(.text.ossl_pool_add_nonce_data)
    *(.text.rand_pool_grow)
    *(.text.ossl_rand_pool_new)
    *(.text.ossl_rand_pool_free)
    *(.text.ossl_rand_pool_buffer)
    *(.text.ossl_rand_pool_length)
    *(.text.ossl_rand_pool_detach)
    *(.text.ossl_rand_pool_entropy_available)
    *(.text.ossl_rand_pool_entropy_needed)
    *(.text.ossl_rand_pool_bytes_needed)
    *(.text.ossl_rand_pool_add)
    *(.text.ossl_rand_pool_add_begin)
    *(.text.ossl_rand_pool_add_end)
    *(.text.ossl_rand_pool_adin_mix_in)
    *(.text.evp_rand_up_ref)
    *(.text.evp_rand_from_algorithm)
    *(.text.drbg_hmac_get_ctx_params)
    *(.text.drbg_hmac_reseed_wrapper)
    *(.text.drbg_hmac_generate_wrapper)
    *(.text.drbg_hmac_uninstantiate)
    *(.text.drbg_hmac_free)
    *(.text.drbg_hmac_new_wrapper)
    *(.text.drbg_hmac_new)
    *(.text.drbg_hmac_set_ctx_params_locked)
    *(.text.drbg_hmac_set_ctx_params)
    *(.text.drbg_hmac_instantiate_wrapper)
    *(.text.drbg_hmac_uninstantiate_wrapper)
    *(.text.drbg_hmac_reseed)
    *(.text.ossl_drbg_hmac_init)
    *(.text.drbg_hmac_instantiate)
    *(.text.ossl_drbg_hmac_generate)
    *(.text.drbg_hmac_generate)
    *(.text.seed_src_instantiate)
    *(.text.seed_src_uninstantiate)
    *(.text.seed_src_gettable_ctx_params)
    *(.text.seed_src_verify_zeroization)
    *(.text.seed_clear_seed)
    *(.text.seed_get_seed)
    *(.text.Io.Writer.Allocating.growingRebase)
    *(.text.Io.Writer.Allocating.sendFile)
    *(.text.mem.Allocator.noAlloc)
    *(.text.mem.Allocator.unreachableFree)
    *(.text.mem.Allocator.unreachableRemap)
    *(.text.mem.Allocator.unreachableResize)
    *(.text.alert_cb)
    *(.text.atexit)
    *(.text.bcmp)
    *(.text.compiler_rt.bcmp)
    *(.text.compiler_rt.ssp.__memset_chk)
    *(.text.__memcpy_chk)
    *(.text.compiler_rt.ssp.__memcpy_chk)
    *(.text.__chk_fail)
    *(.text.__stack_chk_fail)
    *(.text.compiler_rt.ssp.__chk_fail)
    *(.text.__aarch64_ldset8_acq_rel)
    *(.text.compiler_rt.aarch64_outline_atomics.__aarch64_ldset8_acq_rel)
    *(.text.compiler_rt.aarch64_outline_atomics.__aarch64_ldadd8_rel)
    *(.text.__aarch64_ldadd8_acq)
    *(.text.compiler_rt.aarch64_outline_atomics.__aarch64_ldadd8_acq)
    *(.text.__aarch64_ldadd8_relax)
    *(.text.compiler_rt.aarch64_outline_atomics.__aarch64_ldadd8_relax)
    *(.text.compiler_rt.aarch64_outline_atomics.__aarch64_ldadd4_acq_rel)
    *(.text.compiler_rt.aarch64_outline_atomics.__aarch64_ldadd4_rel)
    *(.text.compiler_rt.aarch64_outline_atomics.__aarch64_ldadd4_relax)
    *(.text.compiler_rt.round.roundl)
    *(.text.roundf128)
    *(.text.roundl)
    *(.text.compiler_rt.round.round_f128)
    *(.text.__divtf3)
    *(.text.compiler_rt.divtf3.__divtf3)
    *(.text._start)
    *(.text._dl_relocate_static_pie)
    *(.text.call_weak_fn)
    *(.text.h2_invalid_header)
    *(.text.h2_data)
    *(.text.finish_tx_h2)
    *(.text.append)
    *(.text.map_file)
    *(.text.nghttp2_submit_rst_stream)
    *(.text.nghttp2_frame_priority_free)
    *(.text.nghttp2_frame_rst_stream_init)
    *(.text.nghttp2_frame_rst_stream_free)
    *(.text.nghttp2_frame_push_promise_free)
    *(.text.nghttp2_frame_ping_init)
    *(.text.nghttp2_frame_ping_free)
    *(.text.nghttp2_frame_goaway_init)
    *(.text.nghttp2_frame_goaway_free)
    *(.text.nghttp2_frame_window_update_init)
    *(.text.nghttp2_frame_extension_free)
    *(.text.nghttp2_frame_altsvc_free)
    *(.text.nghttp2_frame_origin_free)
    *(.text.nghttp2_frame_priority_update_free)
    *(.text.nghttp2_frame_pack_priority)
    *(.text.nghttp2_frame_pack_rst_stream)
    *(.text.nghttp2_frame_unpack_rst_stream_payload)
    *(.text.nghttp2_frame_pack_push_promise)
    *(.text.nghttp2_frame_unpack_push_promise_payload)
    *(.text.nghttp2_frame_pack_ping)
    *(.text.nghttp2_frame_unpack_ping_payload)
    *(.text.nghttp2_frame_pack_goaway)
    *(.text.nghttp2_frame_unpack_goaway_payload)
    *(.text.nghttp2_frame_pack_window_update)
    *(.text.nghttp2_frame_pack_altsvc)
    *(.text.nghttp2_frame_unpack_altsvc_payload)
    *(.text.nghttp2_frame_pack_origin)
    *(.text.nghttp2_frame_unpack_origin_payload)
    *(.text.nghttp2_frame_pack_priority_update)
    *(.text.nghttp2_frame_unpack_priority_update_payload)
    *(.text.nghttp2_nv_array_del)
    *(.text.nghttp2_check_header_value)
    *(.text.nghttp2_priority_spec_init)
    *(.text.hd_ringbuf_get.part.0)
    *(.text.pack_first_byte.part.0)
    *(.text.nghttp2_hd_deflate_change_table_size)
    *(.text.nghttp2_hd_inflate_change_table_size)
    *(.text.nghttp2_bufs_realloc)
    *(.text.free_streams)
    *(.text.session_call_error_callback)
    *(.text.session_ob_data_remove.part.0)
    *(.text.find_stream_on_goaway_func)
    *(.text.update_remote_initial_window_size_func)
    *(.text.nghttp2_session_get_stream)
    *(.text.nghttp2_session_add_rst_stream_continue)
    *(.text.session_handle_invalid_stream2)
    *(.text.nghttp2_session_on_altsvc_received)
    *(.text.nghttp2_session_want_write)
    *(.text.nghttp2_session_add_goaway)
    *(.text.session_terminate_session)
    *(.text.session_handle_invalid_connection)
    *(.text.session_update_glitch_ratelim)
    *(.text.nghttp2_session_on_ping_received)
    *(.text.nghttp2_session_on_response_headers_received)
    *(.text.nghttp2_session_on_goaway_received)
    *(.text.nghttp2_session_on_rst_stream_received)
    *(.text.os.glob)
    *(.text.os.freeList)
    *(.text.http.config.Config.deinit)
    *(.text.acme.migrationPath)
    *(.text.json.static.parseFromSliceLeaky__func_1273)
    *(.text.crypto.timing_safe.eql__func_1272)
    *(.text.json.dynamic.handleCompleteValue__func_1295)
    *(.text.fmt.parse_float.convert_slow.convertSlow__func_1308)
    *(.text.fmt.parse_float.convert_eisel_lemire.convertEiselLemire__func_1306)
    *(.text.array_list.AlignedManaged?json.dynamic.Value?null?.ensureTotalCapacity)
    *(.text.array_list.Aligned?u8?null?.append)
    *(.text.array_list.Aligned?u8?null?.print__func_1172)
    *(.text.conn.Conn.onFramesLost)
    *(.text.stream.SendBuf.onLost)
    *(.text.stream.RecvBuf.discard)
    *(.text.conn.Conn.gotAlert)
    *(.text.server.proxy.logUpstreamError)
    *(.text.load_balancer.redirectedTarget)
    *(.text.server.h3.malformed)
    *(.text.h3.Request.abort)
    *(.text.server.conn.Conn.bodyError)
    *(.text.server.proxy.fail)
    *(.text.server.multiplex.closeRequest)
    *(.text.main.master)
    *(.text.main.cleanupActivatedCaches)
    *(.text.main.eprint__func_135)
    *(.text.server.acme_encrypted.restore)
    *(.text.fmt.allocPrint__func_894)
    *(.text.Io.Writer.writeBytePreserve)
    *(.text.compress.flate.Decompress.rebaseFallible)
    *(.text.compress.flate.Decompress.streamDirect)
    *(.text.compress.flate.Decompress.discardDirect)
    *(.text.heap.PageAllocator.remap)
    *(.text.heap.PageAllocator.resize)
    *(.text.heap.c_allocator_impl.remap)
    *(.text.heap.c_allocator_impl.resize)
    *(.text.Io.Writer.Allocating.drain)
    *(.text.Io.Threaded.netAcceptPosix)
    *(.text.Io.Threaded.netListenUnixPosix)
    *(.text.Io.Threaded.netListenIpPosix)
    *(.text.array_list.Aligned?http.diag.Message?null?.append)
    *(.text.fmt.allocPrint__func_305)
    *(.text.main.eprint__func_141)
    *(.text.server.worker.Worker.init)
    *(.text.server.tls.enableBufferPool)
    *(.text.stream.SendBuf.hasPending)
    *(.text.conn.Conn.enterTerminal)
    *(.text.conn.Conn.queueStream)
    *(.text.conn.Conn.maybeFree)
    *(.text.conn.Stream.stopSending)
    *(.text.server.worker.Worker.errlog__func_1274)
    *(.text.http.auth.string)
    *(.text.array_list.Aligned?http.request.Header?null?.append)
    *(.text.server.proxy.readUpstream)
    *(.text.server.proxy.connectNext)
    *(.text.main.openErrorLog)
    *(.text.compress.flate.Decompress.streamInner)
    *(.text.Io.Writer.unreachableDrain)
    *(.text.Io.Threaded.netConnectIpPosix)
    *(.text.Io.Threaded.posixBind)
    *(.text.Io.Threaded.netBindIpPosix)
    *(.text.conn.Conn.maybeWindowUpdate)
    *(.text.websocket.Session.deinit)
    *(.text.server.vars.evalMap)
    *(.text.http.config.Config.findMap)
    *(.text.regex.Regex.search)
    *(.text.http.auth.verify)
    *(.text.http.auth.hasScopes)
    *(.text.server.proxy.resolveDynamic)
    *(.text.http.addr.parseIp4)
    *(.text.http.addr.parseHostPort)
    *(.text.http.addr.parseIp6)
    *(.text.http.addr.parseIp6__struct_1413.f)
    *(.text.acme.matchRank)
    *(.text.os.strerror)
    *(.text.http.addr.Addr.formatIp)
    *(.text.server.tls.freeSni)
    *(.text.Io.Threaded.concurrent)
    *(.text.Io.Threaded.async)
    *(.text.Io.Threaded.crashHandler)
    *(.text.Io.Threaded.Future.start)
    *(.text.Io.Threaded.netShutdownPosix)
    *(.text.Io.Threaded.netConnectUnixPosix)
    *(.text.regex.Regex.run)
    *(.text.crypto.Sha1.round)
    *(.text.server.websocket.token)
    *(.text.os.statZ)
    *(.text.http.auth.decode)
    *(.text.sort.block.block__func_1374)
    *(.text.server.application.hashPart)
    *(.text.sort.block.mergeInPlace__func_1385)
    *(.text.mem.swap__func_1375)
    *(.text.server.proxy.escapedConcat)
    *(.text.fastcgi.record)
    *(.text.fastcgi.length)
    *(.text.main.eprint__func_113)
    *(.text.main.finishAcme)
    *(.text.main.eprint__func_112)
    *(.text.fmt.allocPrint__func_108)
    *(.text.acme.fingerprint)
    *(.text.server.acme_encrypted.equalIdentity)
    *(.text.server.acme_encrypted.Job.deinit)
    *(.text.fmt.allocPrintSentinel__func_98)
  }
} INSERT BEFORE .text;
SECTIONS {
  .rodata.hot : ALIGN(4096) {
    *libcrypto-lib-ecp_nistz256-armv8.o(.rodata)
    *(.rodata.k25519Precomp)
    *(.rodata.huff_decode_table)
    *(.rodata.so)
    *(.rodata.sn_objs)
    *(.rodata.ln_objs)
    *(.rodata.huff_sym_table)
    *(.rodata.nid_to_group)
    *(.rodata.ossl_sm2_asn1_meth)
    *(.rodata.nghttp2_downcase_tbl)
    *(.rodata.kNTTRoots)
    *(.rodata.kModRoots)
    *(.rodata.kInverseNTTRoots)
    *(.rodata.ctype_char_map)
    *(.rodata.VALID_PATH_CHARS)
    *(.rodata.VALID_METHOD_CHARS)
    *(.rodata.VALID_HD_VALUE_CHARS)
    *(.rodata.VALID_HD_NAME_CHARS)
    *(.rodata.VALID_AUTHORITY_CHARS)
    *(.rodata.ssl_cipher_table_cipher)
    *libcrypto-lib-keccak1600-armv8.o(.rodata)
    *(.rodata.CSWTCH.29)
    *(.rodata.ssl_cert_info)
    *(.rodata.default_zeros.0)
    *(.rodata.chain.5)
    *(.rodata.X509_CINF_aux)
    *(.rodata.one.4)
    *(.rodata.kZeros.0)
    *(.rodata.RR.6)
    *(.rodata.nilbn.1)
    *(.rodata.minbits_table.0)
    *(.rodata.__func__.34)
    *(.rodata.__func__.17)
    *(.rodata.crypto.initial_salt_v1)
    *(.rodata.server_handshake_traffic.8)
    *(.rodata.server_application_traffic.7)
    *(.rodata.client_handshake_traffic.10)
    *(.rodata.client_application_traffic.9)
    *(.rodata.resumption_master_secret.6)
    *(.rodata.exporter_master_secret.5)
    *(.rodata.ossl_der_oid_ecdsa_with_SHA384)
    *(.rodata.ossl_der_oid_ecdsa_with_SHA256)
    *(.rodata.nonce_label.6)
    *(.rodata.finishedlabel.18)
    *(.rodata.__func__.4)
    *(.rodata.derived_secret_label.16)
    *(.rodata.label_prefix)
    *(.rodata.keylabel.20)
    *(.rodata.ivlabel.19)
    *(.rodata.CSWTCH.51)
    *(EXCLUDE_FILE(*.a:*) .rodata.str* .rodata.cst*)
    *libssl-lib-statem.o(.rodata.str* .rodata.cst*)
    *libssl-lib-statem_srvr.o(.rodata.str* .rodata.cst*)
    *libcrypto-lib-bn_ctx.o(.rodata.str* .rodata.cst*)
    *libcrypto-lib-dh_ameth.o(.rodata.str* .rodata.cst*)
    *libcrypto-lib-dsa_ameth.o(.rodata.str* .rodata.cst*)
    *libcrypto-lib-curve25519.o(.rodata.str* .rodata.cst*)
    *libcrypto-lib-ec_ameth.o(.rodata.str* .rodata.cst*)
    *libcrypto-lib-ecx_meth.o(.rodata.str* .rodata.cst*)
    *libcrypto-lib-ec_support.o(.rodata.str* .rodata.cst*)
    *libcrypto-lib-p_lib.o(.rodata.str* .rodata.cst*)
    *libcrypto-lib-lhash.o(.rodata.str* .rodata.cst*)
    *libcrypto-lib-params.o(.rodata.str* .rodata.cst*)
    *libcrypto-lib-ml_kem.o(.rodata.str* .rodata.cst*)
    *libcrypto-lib-obj_dat.o(.rodata.str* .rodata.cst*)
    *libcrypto-lib-sha256.o(.rodata.str* .rodata.cst*)
    *libcrypto-lib-sha512.o(.rodata.str* .rodata.cst*)
    *libcrypto-lib-defltprov.o(.rodata.str* .rodata.cst*)
    *libdefault-lib-digest_to_nid.o(.rodata.str* .rodata.cst*)
    *libdefault-lib-ml_kem_kem.o(.rodata.str* .rodata.cst*)
    *libdefault-lib-mlx_kmgmt.o(.rodata.str* .rodata.cst*)
    *libdefault-lib-hmac_prov.o(.rodata.str* .rodata.cst*)
    *libdefault-lib-drbg_ctr.o(.rodata.str* .rodata.cst*)
    *libcommon-lib-provider_ctx.o(.rodata.str* .rodata.cst*)
    *nghttp2_session.c.o(.rodata.str* .rodata.cst*)
    *nghttp2_hd.c.o(.rodata.str* .rodata.cst*)
  }
} INSERT BEFORE .rodata;
SECTIONS {
  .data.rel.ro : {
    *(.data.rel.ro.local.nid_objs)
    *(.data.rel.ro.local.static_table)
    *(.data.rel.ro.ext_defs)
    *(.data.rel.ro.curve_list)
    *(.data.rel.ro.local.ossl_dsa_asn1_meths)
    *(.data.rel.ro.SSL_SESSION_ASN1_seq_tt)
    *(.data.rel.ro.local.ossl_rsa_asn1_meths)
    *(.data.rel.ro.deflt_kdfs)
    *(.data.rel.ro.ret.9)
    *(.data.rel.ro.local.known_settable_ctx_params)
    *(.data.rel.ro.deflt_asym_kem)
    *(.data.rel.ro.local.hpke_kem_tab)
    *(.data.rel.ro.local.ossl_rsa_pss_asn1_meth)
    *(.data.rel.ro.local.ossl_ed448_asn1_meth)
    *(.data.rel.ro.local.ossl_ed25519_asn1_meth)
    *(.data.rel.ro.local.ossl_ecx448_asn1_meth)
    *(.data.rel.ro.local.ossl_ecx25519_asn1_meth)
    *(.data.rel.ro.local.ossl_eckey_asn1_meth)
    *(.data.rel.ro.local.ossl_dhx_asn1_meth)
    *(.data.rel.ro.local.ossl_dh_asn1_meth)
    *(.data.rel.ro.deflt_macs)
    *(.data.rel.ro.ossl_v3_alt)
    *(.data.rel.ro.local.aes_256_gcm)
    *(.data.rel.ro.local.aes_128_gcm)
    *(.data.rel.ro.local.vinfo_map)
    *(.data.rel.ro.tlsv1_client_method_data.10)
    *(.data.rel.ro.tlsv1_3_server_method_data.18)
    *(.data.rel.ro.tlsv1_3_client_method_data.13)
    *(.data.rel.ro.tlsv1_2_client_method_data.12)
    *(.data.rel.ro.tlsv1_1_client_method_data.11)
    *(.data.rel.ro.local.md5_md)
    *(.data.rel.ro.TLS_server_method_data.19)
    *(.data.rel.ro.local.quic_tls_record_method)
    *(.data.rel.ro.ossl_tls_record_method)
    *(.data.rel.ro.PKCS8_PRIV_KEY_INFO_seq_tt)
    *(.data.rel.ro.local.standard_name2type)
    *(.data.rel.ro.local.ossl_rsa_asym_kem_functions)
    *(.data.rel.ro.local.hybrid_vtable)
    *(.data.rel.ro.local.ossl_siphash_functions)
    *(.data.rel.ro.local.ossl_poly1305_functions)
    *(.data.rel.ro.local.ossl_kmac256_functions)
    *(.data.rel.ro.local.ossl_kmac128_functions)
    *(.data.rel.ro.local.ossl_hmac_functions)
    *(.data.rel.ro.local.ossl_gmac_functions)
    *(.data.rel.ro.local.ossl_ecx_asym_kem_functions)
    *(.data.rel.ro.local.ossl_ec_asym_kem_functions)
    *(.data.rel.ro.local.ossl_cmac_functions)
    *(.data.rel.ro.local.ossl_blake2smac_functions)
    *(.data.rel.ro.local.ossl_blake2bmac_functions)
    *(.data.rel.ro.local.name_to_nid.0)
    *(.data.rel.ro.local.ossl_kdf_x963_kdf_functions)
    *(.data.rel.ro.local.ossl_kdf_x942_kdf_functions)
    *(.data.rel.ro.local.ossl_kdf_tls1_prf_functions)
    *(.data.rel.ro.local.ossl_kdf_tls1_3_kdf_functions)
    *(.data.rel.ro.local.ossl_kdf_sskdf_functions)
    *(.data.rel.ro.local.ossl_kdf_sshkdf_functions)
    *(.data.rel.ro.local.ossl_kdf_scrypt_functions)
    *(.data.rel.ro.local.ossl_kdf_pkcs12_functions)
    *(.data.rel.ro.local.ossl_kdf_pbkdf2_functions)
    *(.data.rel.ro.local.ossl_kdf_krb5kdf_functions)
    *(.data.rel.ro.local.ossl_kdf_kbkdf_functions)
    *(.data.rel.ro.local.ossl_kdf_hmac_drbg_functions)
    *(.data.rel.ro.local.ossl_kdf_hkdf_functions)
    *(.data.rel.ro.tls_version_table)
    *(.data.rel.ro.tls_any_funcs)
    *(.data.rel.ro.tls_1_3_funcs)
    *(.data.rel.ro.local.ossl_mlx_kem_asym_kem_functions)
    *(.data.rel.ro.local.ossl_ml_kem_asym_kem_functions)
    *(.data.rel.ro.local.ossl_kdf_argon2id_functions)
    *(.data.rel.ro.local.ossl_kdf_argon2i_functions)
    *(.data.rel.ro.local.ossl_kdf_argon2d_functions)
    *(.data.rel.ro.openssl_ec_key_method)
    *(.data.rel.ro.local.known_settable_eckem_ctx_params)
    *(.data.rel.ro.X509_seq_tt)
    *(.data.rel.ro.secmem_method)
    *(.data.rel.ro.null_method)
    *(.data.rel.ro.methods_sockp)
    *(.data.rel.ro.methods_readbuffer)
    *(.data.rel.ro.methods_buffer)
    *(.data.rel.ro.mem_method)
    *(.data.rel.ro.conn.Conn.dispatch)
    *(.data.rel.ro.TLSv1_3_enc_data)
    *(.data.rel.ro.TLSv1_2_enc_data)
    *(.data.rel.ro.ossl_v3_sinfo)
    *(.data.rel.ro.ossl_v3_info)
    *(.data.rel.ro.local.ui_null)
    *(.data.rel.ro.rlayer_dispatch)
    *(.data.rel.ro.X509_PUBKEY_INTERNAL_seq_tt)
    *(.data.rel.ro.X509_ATTRIBUTE_seq_tt)
    *(.data.rel.ro.X509_ALGOR_seq_tt)
    *(.data.rel.ro.OTHERNAME_seq_tt)
    *(.data.rel.ro.EDIPARTYNAME_seq_tt)
    *(.data.rel.ro.ACCESS_DESCRIPTION_seq_tt)
    *(.data.rel.ro.local.x509_pubkey_ff)
    *(.data.rel.ro.local.local_it.9)
    *(.data.rel.ro.local.local_it.7)
    *(.data.rel.ro.local.local_it.5)
    *(.data.rel.ro.local.local_it.3)
    *(.data.rel.ro.local.local_it.26)
    *(.data.rel.ro.local.local_it.23)
    *(.data.rel.ro.local.local_it.20)
    *(.data.rel.ro.local.local_it.2)
    *(.data.rel.ro.local.local_it.18)
    *(.data.rel.ro.local.local_it.17)
    *(.data.rel.ro.local.local_it.16)
    *(.data.rel.ro.local.local_it.14)
    *(.data.rel.ro.local.local_it.13)
    *(.data.rel.ro.local.local_it.11)
    *(.data.rel.ro.local.local_it.10)
    *(.data.rel.ro.local.local_it.1)
    *(.data.rel.ro.local.local_it.0)
    *(.data.rel.ro.local.internal_adb.19)
    *(.data.rel.ro.local.internal_adb.15)
    *(.data.rel.ro.local.format_nameid_map)
    *(.data.rel.ro.local.check_group_type_nameid_map)
    *(.data.rel.ro.armv8_aes_gcm)
    *(.data.rel.ro.local.X509_aux)
    *(.data.rel.ro.local.PKCS8_PRIV_KEY_INFO_aux)
    *(.data.rel.ro.AUTHORITY_INFO_ACCESS_item_tt)
    *(.data.rel.ro.heap.c_allocator_impl.vtable)
    *(.data.rel.ro.local.encoding_nameid_map)
    *(.data.rel.ro.local.shake_generic_md)
    *(.data.rel.ro.local.sha3_generic_md)
    *(.data.rel.ro.aes_arm_ecb)
    *(.data.rel.ro.aes_arm_ctr)
    *(.data.rel.ro.aes_arm_cbc)
    *(.data.rel.ro.local._bignum_small_prime_factors)
    *(.data.rel.ro .data.rel.ro.*)
  }
} INSERT BEFORE .dynamic;
